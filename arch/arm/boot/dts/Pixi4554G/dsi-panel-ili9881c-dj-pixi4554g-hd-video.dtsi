/* Copyright (c) 2014, The Linux Foundation. All rights reserved.
 *
 * This program is free software; you can redistribute it and/or modify
 * it under the terms of the GNU General Public License version 2 and
 * only version 2 as published by the Free Software Foundation.
 *
 * This program is distributed in the hope that it will be useful,
 * but WITHOUT ANY WARRANTY; without even the implied warranty of
 * MERCHANTABILITY or FITNESS FOR A PARTICULAR PURPOSE.  See the
 * GNU General Public License for more details.
 */

/*---------------------------------------------------------------------------
 * This file is autogenerated file using gcdb parser. Please do not edit it.
 * Update input XML file to add a new entry or update variable in this file
 * VERSION = "1.0"
 *---------------------------------------------------------------------------*/
&mdss_mdp {
	dsi_ili9881c_dj_Pixi4554G_hd_vid: qcom,mdss_dsi_ili9881c_dj_Pixi4554G_hd_video {
		qcom,mdss-dsi-panel-name = "ili9881c dj_Pixi4554G hd video mode dsi panel[20160315_v1]";
		qcom,mdss-dsi-panel-controller = <&mdss_dsi0>;
		qcom,mdss-dsi-panel-type = "dsi_video_mode";
		qcom,mdss-dsi-panel-destination = "display_1";
		qcom,mdss-dsi-panel-framerate = <60>;
		qcom,mdss-dsi-virtual-channel-id = <0>;
		qcom,mdss-dsi-stream = <0>;
		qcom,mdss-dsi-panel-width = <720>;
		qcom,mdss-dsi-panel-height = <1280>;
		qcom,mdss-dsi-h-front-porch = <110>;//90
		qcom,mdss-dsi-h-back-porch = <160>;//97
		qcom,mdss-dsi-h-pulse-width = <58>;
		qcom,mdss-dsi-h-sync-skew = <0>;
        qcom,mdss-dsi-v-front-porch = <12>;
		qcom,mdss-dsi-v-back-porch = <18>;
		qcom,mdss-dsi-v-pulse-width = <4>;
		//modify end at 20151230 for FIX TP error
		qcom,mdss-dsi-h-left-border = <0>;
		qcom,mdss-dsi-h-right-border = <0>;
		qcom,mdss-dsi-v-top-border = <0>;
		qcom,mdss-dsi-v-bottom-border = <0>;
		qcom,mdss-dsi-bpp = <24>;
		qcom,mdss-dsi-underflow-color = <0xff>;
		qcom,mdss-dsi-border-color = <0>;
		qcom,mdss-dsi-on-command = [
29 01 00 00 00 00 04 FF 98 81 03
//GIP_1
29 01 00 00 00 00 02 01 00
29 01 00 00 00 00 02 02 00
29 01 00 00 00 00 02 03 73
29 01 00 00 00 00 02 04 00
29 01 00 00 00 00 02 05 00
29 01 00 00 00 00 02 06 0C
29 01 00 00 00 00 02 07 00
29 01 00 00 00 00 02 08 00
29 01 00 00 00 00 02 09 19
29 01 00 00 00 00 02 0a 01
29 01 00 00 00 00 02 0b 01
29 01 00 00 00 00 02 0c 0B
29 01 00 00 00 00 02 0d 01
29 01 00 00 00 00 02 0e 01
29 01 00 00 00 00 02 0f 26
29 01 00 00 00 00 02 10 26
29 01 00 00 00 00 02 11 00
29 01 00 00 00 00 02 12 00
29 01 00 00 00 00 02 13 02
29 01 00 00 00 00 02 14 00
29 01 00 00 00 00 02 15 00
29 01 00 00 00 00 02 16 00
29 01 00 00 00 00 02 17 00
29 01 00 00 00 00 02 18 00
29 01 00 00 00 00 02 19 00
29 01 00 00 00 00 02 1a 00
29 01 00 00 00 00 02 1b 00
29 01 00 00 00 00 02 1c 00
29 01 00 00 00 00 02 1d 00
29 01 00 00 00 00 02 1e 44
29 01 00 00 00 00 02 1f C0 
29 01 00 00 00 00 02 20 0A
29 01 00 00 00 00 02 21 03
29 01 00 00 00 00 02 22 0A 
29 01 00 00 00 00 02 23 00
29 01 00 00 00 00 02 24 8C 
29 01 00 00 00 00 02 25 8C
29 01 00 00 00 00 02 26 00
29 01 00 00 00 00 02 27 00
29 01 00 00 00 00 02 28 3B     // 33
29 01 00 00 00 00 02 29 03
29 01 00 00 00 00 02 2a 00
29 01 00 00 00 00 02 2b 00
29 01 00 00 00 00 02 2c 00
29 01 00 00 00 00 02 2d 00
29 01 00 00 00 00 02 2e 00
29 01 00 00 00 00 02 2f 00
29 01 00 00 00 00 02 30 00
29 01 00 00 00 00 02 31 00
29 01 00 00 00 00 02 32 00
29 01 00 00 00 00 02 33 00
29 01 00 00 00 00 02 34 00
29 01 00 00 00 00 02 35 00
29 01 00 00 00 00 02 36 00
29 01 00 00 00 00 02 37 00
29 01 00 00 00 00 02 38 00
29 01 00 00 00 00 02 39 00
29 01 00 00 00 00 02 3a 00
29 01 00 00 00 00 02 3b 00
29 01 00 00 00 00 02 3c 00
29 01 00 00 00 00 02 3d 00
29 01 00 00 00 00 02 3e 00
29 01 00 00 00 00 02 3f 00
29 01 00 00 00 00 02 40 00
29 01 00 00 00 00 02 41 00
29 01 00 00 00 00 02 42 00
29 01 00 00 00 00 02 43 00
29 01 00 00 00 00 02 44 00
//GIP_2
29 01 00 00 00 00 02 50 01
29 01 00 00 00 00 02 51 23
29 01 00 00 00 00 02 52 45
29 01 00 00 00 00 02 53 67
29 01 00 00 00 00 02 54 89
29 01 00 00 00 00 02 55 ab
29 01 00 00 00 00 02 56 01
29 01 00 00 00 00 02 57 23
29 01 00 00 00 00 02 58 45
29 01 00 00 00 00 02 59 67
29 01 00 00 00 00 02 5a 89
29 01 00 00 00 00 02 5b ab
29 01 00 00 00 00 02 5c cd
29 01 00 00 00 00 02 5d ef
//GIP_3
29 01 00 00 00 00 02 5e 11
29 01 00 00 00 00 02 5f 02
29 01 00 00 00 00 02 60 00
29 01 00 00 00 00 02 61 0C
29 01 00 00 00 00 02 62 0D
29 01 00 00 00 00 02 63 0E
29 01 00 00 00 00 02 64 0F
29 01 00 00 00 00 02 65 02
29 01 00 00 00 00 02 66 02
29 01 00 00 00 00 02 67 02
29 01 00 00 00 00 02 68 02
29 01 00 00 00 00 02 69 02
29 01 00 00 00 00 02 6a 02
29 01 00 00 00 00 02 6b 02
29 01 00 00 00 00 02 6c 02
29 01 00 00 00 00 02 6d 02
29 01 00 00 00 00 02 6e 05
29 01 00 00 00 00 02 6f 05
29 01 00 00 00 00 02 70 05
29 01 00 00 00 00 02 71 05
29 01 00 00 00 00 02 72 01
29 01 00 00 00 00 02 73 06
29 01 00 00 00 00 02 74 07
29 01 00 00 00 00 02 75 02
29 01 00 00 00 00 02 76 00
29 01 00 00 00 00 02 77 0C
29 01 00 00 00 00 02 78 0D
29 01 00 00 00 00 02 79 0E
29 01 00 00 00 00 02 7a 0F
29 01 00 00 00 00 02 7b 02
29 01 00 00 00 00 02 7c 02
29 01 00 00 00 00 02 7d 02
29 01 00 00 00 00 02 7e 02
29 01 00 00 00 00 02 7f 02
29 01 00 00 00 00 02 80 02
29 01 00 00 00 00 02 81 02
29 01 00 00 00 00 02 82 02
29 01 00 00 00 00 02 83 02
29 01 00 00 00 00 02 84 05
29 01 00 00 00 00 02 85 05
29 01 00 00 00 00 02 86 05
29 01 00 00 00 00 02 87 05
29 01 00 00 00 00 02 88 01
29 01 00 00 00 00 02 89 06
29 01 00 00 00 00 02 8A 07


//CMD_Page 4
29 01 00 00 00 00 04 FF 98 81 04
29 01 00 00 00 00 02 6C 15
29 01 00 00 00 00 02 6E 1A              //di_pwr_reg=0 VGH clamp 15V
29 01 00 00 00 00 02 6F 25             // reg vcl + VGH pumping ratio 3x VGL=-2x
29 01 00 00 00 00 02 3A A4               
29 01 00 00 00 00 02 8D 20               //VGL clamp -10V
29 01 00 00 00 00 02 87 BA     
29 01 00 00 00 00 02 26 76		//5.2 none
29 01 00 00 00 00 02 b2 d1          //5.2 none


//CMD_Page 1
29 01 00 00 00 00 04 FF 98 81 01
29 01 00 00 00 00 02 22 0A		//BGR SS
29 01 00 00 00 00 02 53 7D		//VCOM1
29 01 00 00 00 00 02 55 8A		//VCOM2
29 01 00 00 00 00 02 50 95         	//VREG1OUT=4.9V
29 01 00 00 00 00 02 51 95         	//VREG2OUT=-4.9V
29 01 00 00 00 00 02 31 00		//column inversion
29 01 00 00 00 00 02 60 15 //15//09              //SDT
29 01 00 00 00 00 02 61 01               //SDT
29 01 00 00 00 00 02 62 0c               //SDT
29 01 00 00 00 00 02 63 00               //SDT
  

//VP255	Gamma P
29 01 00 00 00 00 02 A0 1D//VP251		
29 01 00 00 00 00 02 A1 26//VP247                       
29 01 00 00 00 00 02 A2 2e//VP243                       
29 01 00 00 00 00 02 A3 14//VP239                       
29 01 00 00 00 00 02 A4 14 //VP231                       
29 01 00 00 00 00 02 A5 21//VP219                       
29 01 00 00 00 00 02 A6 17//VP203                      
29 01 00 00 00 00 02 A7 19//VP175                       
29 01 00 00 00 00 02 A8 65//VP144                       
29 01 00 00 00 00 02 A9 1b//VP111                       
29 01 00 00 00 00 02 AA 28//VP80                       
29 01 00 00 00 00 02 AB 4e//VP52                        
29 01 00 00 00 00 02 AC 12//VP36                        
29 01 00 00 00 00 02 AD 0a//VP24                        
29 01 00 00 00 00 02 AE 38//VP16                        
29 01 00 00 00 00 02 AF 00//VP12                        
29 01 00 00 00 00 02 B0 00//VP8                        
29 01 00 00 00 00 02 B1 5E//VP4                         
29 01 00 00 00 00 02 B2 6D//VP0                          
29 01 00 00 00 00 02 B3 39                       
   
//VN255 GAMMA N                                               
29 01 00 00 00 00 02 C0 1D//VN251
29 01 00 00 00 00 02 C1 25//VN247                       
29 01 00 00 00 00 02 C2 2c//VN243                      
29 01 00 00 00 00 02 C3 07//VN239                        
29 01 00 00 00 00 02 C4 08//VN231                      
29 01 00 00 00 00 02 C5 1d//VN219                       
29 01 00 00 00 00 02 C6 11//VN203                       
29 01 00 00 00 00 02 C7 14//VN175                       
29 01 00 00 00 00 02 C8 66//VN144                       
29 01 00 00 00 00 02 C9 1c//VN111                       
29 01 00 00 00 00 02 CA 27//VN80                       
29 01 00 00 00 00 02 CB 4c//VN52                        
29 01 00 00 00 00 02 CC 0e//VN36                        
29 01 00 00 00 00 02 CD 02//VN24                        
29 01 00 00 00 00 02 CE 2a//VN16                        
29 01 00 00 00 00 02 CF 00//VN12                        
29 01 00 00 00 00 02 D0 00 //VN8                       
29 01 00 00 00 00 02 D1 61//VN4                         
29 01 00 00 00 00 02 D2 6F//VN0                         
29 01 00 00 00 00 02 D3 39             

29 01 00 00 00 00 04 FF 98 81 00
29 01 00 00 00 00 02 35 00
05 01 00 00 78 00 02 11 00	//sleep out         
05 01 00 00 14 00 02 29 00	//display on
			//39 01 00 00 00 00 04 FF 98 81 08
];	
		qcom,mdss-dsi-off-command = [ 	05 01 00 00 32 00 02 28 00
						05 01 00 00 78 00 02 10 00];
		qcom,mdss-dsi-on-command-state = "dsi_lp_mode";
		qcom,mdss-dsi-off-command-state = "dsi_lp_mode";
        //modify by yusen.ke.sz@tcl.com for change esd check mode     
        qcom,esd-check-enabled;
        //qcom,mdss-dsi-panel-status-check-mode = "te_signal_check"; 
        qcom,mdss-dsi-panel-status-command = [
		06 01 00 01 05 00 02 0a 00
		];
		qcom,mdss-dsi-panel-status-command-state = "dsi_lp_mode";
		qcom,mdss-dsi-panel-status-check-mode = "reg_read";
		qcom,mdss-dsi-panel-status-value = <0x9C>;
		//modify end
		qcom,mdss-dsi-h-sync-pulse = <1>;
		qcom,mdss-dsi-traffic-mode = "burst_mode";
		qcom,mdss-dsi-bllp-eof-power-mode;
		qcom,mdss-dsi-bllp-power-mode;

		qcom,mdss-dsi-lane-0-state;
		qcom,mdss-dsi-lane-1-state;
		qcom,mdss-dsi-lane-2-state;
		qcom,mdss-dsi-lane-3-state;
		//qcom,mdss-dsi-panel-timings = [87 1C 12 00 42 44 18 20 17 03 04 00];
		qcom,mdss-dsi-panel-timings = [8b 1e 14 00 44 48 18 22 19 03 04 00];
		qcom,mdss-dsi-t-clk-post = <0x04>;
		qcom,mdss-dsi-t-clk-pre = <0x1C>;
		qcom,mdss-dsi-bl-min-level = <1>;
		qcom,mdss-dsi-bl-max-level = <255>;
		qcom,mdss-dsi-post-init-delay = <4>;
                /*Before reset, beginning LP11*/
        qcom,mdss-dsi-lp11-init;
		qcom,mdss-dsi-init-delay-us = <50000>;
               
		qcom,mdss-dsi-dma-trigger = "trigger_sw";
		qcom,mdss-dsi-mdp-trigger = "none";
		qcom,mdss-dsi-bl-pmic-control-type = "bl_ctrl_gpio";
		qcom,mdss-dsi-reset-sequence = <1 10>, <0 10>, <1 120>;
		//add by yusen.ke.sz@tcl.com for fix Screen size error(display tester APK)
		qcom,mdss-pan-physical-width-dimension = <69>;
		qcom,mdss-pan-physical-height-dimension = <120>;
		//add end
		/*add begin by yusen.ke.sz@tcl.com at 20160413 for clk and data per line goes to lp11*/
		qcom,mdss-dsi-hfp-power-mode;
		qcom,mdss-dsi-hbp-power-mode;
		qcom,mdss-dsi-hsa-power-mode;
		/*add end by yusen.ke.sz@tcl.com at 20160413 for clk and data per line goes to lp11*/
	};
};

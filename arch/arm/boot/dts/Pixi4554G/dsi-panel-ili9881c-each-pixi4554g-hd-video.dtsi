/* Copyright (c) 2014, The Linux Foundation. All rights reserved.
 *
 * This program is free software; you can redistribute it and/or modify
 * it under the terms of the GNU General Public License version 2 and
 * only version 2 as published by the Free Software Foundation.
 *
 * This program is distributed in the hope that it will be useful,
 * but WITHOUT ANY WARRANTY; without even the implied warranty of
 * MERCHANTABILITY or FITNESS FOR A PARTICULAR PURPOSE.  See the
 * GNU General Public License for more details.
 */

/*---------------------------------------------------------------------------
 * This file is autogenerated file using gcdb parser. Please do not edit it.
 * Update input XML file to add a new entry or update variable in this file
 * VERSION = "1.0"
 *---------------------------------------------------------------------------*/
&mdss_mdp {
	dsi_ili9881c_each_Pixi4554G_hd_vid: qcom,mdss_dsi_ili9881c_each_Pixi4554G_hd_video {
		qcom,mdss-dsi-panel-name = "ili9881c each Pixi4554G hd video mode dsi panel[20160330_v1]";
		qcom,mdss-dsi-panel-controller = <&mdss_dsi0>;
		qcom,mdss-dsi-panel-type = "dsi_video_mode";
		qcom,mdss-dsi-panel-destination = "display_1";
		qcom,mdss-dsi-panel-framerate = <60>;
		qcom,mdss-dsi-virtual-channel-id = <0>;
		qcom,mdss-dsi-stream = <0>;
		qcom,mdss-dsi-panel-width = <720>;
		qcom,mdss-dsi-panel-height = <1280>;
		qcom,mdss-dsi-h-front-porch = <90>;
		qcom,mdss-dsi-h-back-porch = <97>;
		qcom,mdss-dsi-h-pulse-width = <58>;
		qcom,mdss-dsi-h-sync-skew = <0>;
        qcom,mdss-dsi-v-front-porch = <12>;
		qcom,mdss-dsi-v-back-porch = <18>;
		qcom,mdss-dsi-v-pulse-width = <4>;
		//modify end at 20151230 for FIX TP error
		qcom,mdss-dsi-h-left-border = <0>;
		qcom,mdss-dsi-h-right-border = <0>;
		qcom,mdss-dsi-v-top-border = <0>;
		qcom,mdss-dsi-v-bottom-border = <0>;
		qcom,mdss-dsi-bpp = <24>;
		qcom,mdss-dsi-underflow-color = <0xff>;
		qcom,mdss-dsi-border-color = <0>;
		qcom,mdss-dsi-on-command = [
29 01 00 00 00 00 04 FF 98 81 03
//GIP_1
29 01 00 00 00 00 02 01 00
29 01 00 00 00 00 02 02 00
29 01 00 00 00 00 02 03 72
29 01 00 00 00 00 02 04 00
29 01 00 00 00 00 02 05 00
29 01 00 00 00 00 02 06 09
29 01 00 00 00 00 02 07 00
29 01 00 00 00 00 02 08 00
29 01 00 00 00 00 02 09 01
29 01 00 00 00 00 02 0a 00
29 01 00 00 00 00 02 0b 00
29 01 00 00 00 00 02 0c 01
29 01 00 00 00 00 02 0d 00
29 01 00 00 00 00 02 0e 00
29 01 00 00 00 00 02 0f 00     
29 01 00 00 00 00 02 10 00   
29 01 00 00 00 00 02 11 00
29 01 00 00 00 00 02 12 00
29 01 00 00 00 00 02 13 00
29 01 00 00 00 00 02 14 00
29 01 00 00 00 00 02 15 00   
29 01 00 00 00 00 02 16 00   
29 01 00 00 00 00 02 17 00
29 01 00 00 00 00 02 18 00
29 01 00 00 00 00 02 19 00
29 01 00 00 00 00 02 1a 00
29 01 00 00 00 00 02 1b 00
29 01 00 00 00 00 02 1c 00
29 01 00 00 00 00 02 1d 00
29 01 00 00 00 00 02 1e 40
29 01 00 00 00 00 02 1f 80
29 01 00 00 00 00 02 20 05
29 01 00 00 00 00 02 21 02
29 01 00 00 00 00 02 22 00
29 01 00 00 00 00 02 23 00
29 01 00 00 00 00 02 24 00
29 01 00 00 00 00 02 25 00
29 01 00 00 00 00 02 26 00
29 01 00 00 00 00 02 27 00
29 01 00 00 00 00 02 28 33
29 01 00 00 00 00 02 29 02
29 01 00 00 00 00 02 2a 00
29 01 00 00 00 00 02 2b 00
29 01 00 00 00 00 02 2c 00
29 01 00 00 00 00 02 2d 00
29 01 00 00 00 00 02 2e 00
29 01 00 00 00 00 02 2f 00
29 01 00 00 00 00 02 30 00
29 01 00 00 00 00 02 31 00
29 01 00 00 00 00 02 32 00
29 01 00 00 00 00 02 33 00
29 01 00 00 00 00 02 34 04
29 01 00 00 00 00 02 35 00
29 01 00 00 00 00 02 36 00
29 01 00 00 00 00 02 37 00
29 01 00 00 00 00 02 38 3C    
29 01 00 00 00 00 02 39 00
29 01 00 00 00 00 02 3a 40 
29 01 00 00 00 00 02 3b 40
29 01 00 00 00 00 02 3c 00
29 01 00 00 00 00 02 3d 00
29 01 00 00 00 00 02 3e 00
29 01 00 00 00 00 02 3f 00
29 01 00 00 00 00 02 40 00
29 01 00 00 00 00 02 41 00
29 01 00 00 00 00 02 42 00
29 01 00 00 00 00 02 43 00
29 01 00 00 00 00 02 44 00
 //GIP_2
29 01 00 00 00 00 02 50 01
29 01 00 00 00 00 02 51 23
29 01 00 00 00 00 02 52 45
29 01 00 00 00 00 02 53 67
29 01 00 00 00 00 02 54 89
29 01 00 00 00 00 02 55 ab
29 01 00 00 00 00 02 56 01
29 01 00 00 00 00 02 57 23
29 01 00 00 00 00 02 58 45
29 01 00 00 00 00 02 59 67
29 01 00 00 00 00 02 5a 89
29 01 00 00 00 00 02 5b ab
29 01 00 00 00 00 02 5c cd
29 01 00 00 00 00 02 5d ef
//GIP_3
29 01 00 00 00 00 02 5e 11
29 01 00 00 00 00 02 5f 01
29 01 00 00 00 00 02 60 00
29 01 00 00 00 00 02 61 15
29 01 00 00 00 00 02 62 14
29 01 00 00 00 00 02 63 0E
29 01 00 00 00 00 02 64 0F
29 01 00 00 00 00 02 65 0C
29 01 00 00 00 00 02 66 0D
29 01 00 00 00 00 02 67 06
29 01 00 00 00 00 02 68 02
29 01 00 00 00 00 02 69 02
29 01 00 00 00 00 02 6a 02
29 01 00 00 00 00 02 6b 02
29 01 00 00 00 00 02 6c 02
29 01 00 00 00 00 02 6d 02
29 01 00 00 00 00 02 6e 07
29 01 00 00 00 00 02 6f 02
29 01 00 00 00 00 02 70 02
29 01 00 00 00 00 02 71 02
29 01 00 00 00 00 02 72 02
29 01 00 00 00 00 02 73 02
29 01 00 00 00 00 02 74 02
29 01 00 00 00 00 02 75 01
29 01 00 00 00 00 02 76 00
29 01 00 00 00 00 02 77 14
29 01 00 00 00 00 02 78 15
29 01 00 00 00 00 02 79 0E
29 01 00 00 00 00 02 7a 0F
29 01 00 00 00 00 02 7b 0C
29 01 00 00 00 00 02 7c 0D
29 01 00 00 00 00 02 7D 06			
29 01 00 00 00 00 02 7E 02
29 01 00 00 00 00 02 7F 02
29 01 00 00 00 00 02 80 02
29 01 00 00 00 00 02 81 02
29 01 00 00 00 00 02 82 02
29 01 00 00 00 00 02 83 02
29 01 00 00 00 00 02 84 07
29 01 00 00 00 00 02 85 02
29 01 00 00 00 00 02 86 02
29 01 00 00 00 00 02 87 02
29 01 00 00 00 00 02 88 02
29 01 00 00 00 00 02 89 02
29 01 00 00 00 00 02 8A 02
 //CMD_Page 4
29 01 00 00 00 00 04 FF 98 81 04
29 01 00 00 00 00 02 6C 15                
29 01 00 00 00 00 02 6E 2A               
29 01 00 00 00 00 02 6F 33              
29 01 00 00 00 00 02 3A 94               
29 01 00 00 00 00 02 8D 16              
29 01 00 00 00 00 02 87 BA                    
29 01 00 00 00 00 02 26 76            
29 01 00 00 00 00 02 B2 D1
29 01 00 00 00 00 02 B5 06
29 01 00 00 00 00 02 31 75
29 01 00 00 00 00 02 35 1F
 //CMD_Page 1
29 01 00 00 00 00 04 FF 98 81 01
29 01 00 00 00 00 02 22 0A		
29 01 00 00 00 00 02 31 00		
29 01 00 00 00 00 02 53 88		//VCOM1
29 01 00 00 00 00 02 55 8F		//VCOM2
29 01 00 00 00 00 02 50 AE		//VREG1OUT   4.8
29 01 00 00 00 00 02 51 AE		//VREG2OUT   4.8
 
29 01 00 00 00 00 02 60 28  
 
29 01 00 00 00 00 02 63 00 

//VP255	Gamma P
29 01 00 00 00 00 02 A0 10
		
29 01 00 00 00 00 02 A1 1d               //VP251        
29 01 00 00 00 00 02 A2 2d               //VP247        
29 01 00 00 00 00 02 A3 13               //VP243        
29 01 00 00 00 00 02 A4 16               //VP239        
29 01 00 00 00 00 02 A5 2b               //VP231        
29 01 00 00 00 00 02 A6 1B               //VP219        
29 01 00 00 00 00 02 A7 21               //VP203        
29 01 00 00 00 00 02 A8 85               //VP175        
29 01 00 00 00 00 02 A9 1e               //VP144        
29 01 00 00 00 00 02 AA 2a              //VP111        
29 01 00 00 00 00 02 AB 70               //VP80         
29 01 00 00 00 00 02 AC 1c               //VP52         
29 01 00 00 00 00 02 AD 19               //VP36         
29 01 00 00 00 00 02 AE 4d               //VP24         
29 01 00 00 00 00 02 AF 22               //VP16         
29 01 00 00 00 00 02 B0 27               //VP12         
29 01 00 00 00 00 02 B1 51               //VP8          
29 01 00 00 00 00 02 B2 64              //VP4          
29 01 00 00 00 00 02 B3 3c               //VP0          
      //VN255 GAMMA N          
29 01 00 00 00 00 02 C0 10
		
29 01 00 00 00 00 02 C1 1d              //VN251        
29 01 00 00 00 00 02 C2 2d               //VN247        
29 01 00 00 00 00 02 C3 13               //VN243        
29 01 00 00 00 00 02 C4 16               //VN239        
29 01 00 00 00 00 02 C5 2b               //VN231        
29 01 00 00 00 00 02 C6 1b               //VN219        
29 01 00 00 00 00 02 C7 21               //VN203        
29 01 00 00 00 00 02 C8 85               //VN175        
29 01 00 00 00 00 02 C9 1e               //VN144        
29 01 00 00 00 00 02 CA 2a               //VN111        
29 01 00 00 00 00 02 CB 70              //VN80         
29 01 00 00 00 00 02 CC 1c               //VN52         
29 01 00 00 00 00 02 CD 19               //VN36         
29 01 00 00 00 00 02 CE 4d              //VN24         
29 01 00 00 00 00 02 CF 22               //VN16         
29 01 00 00 00 00 02 D0 27               //VN12         
29 01 00 00 00 00 02 D1 51               //VN8          
29 01 00 00 00 00 02 D2 64               //VN4          
29 01 00 00 00 00 02 D3 3c               //VN0
 //CMD_Page 0
29 01 00 00 00 00 04 FF 98 81 00
29 01 00 00 00 00 02 35 00
05 01 00 00 78 00 02 11 00	//sleep out         
05 01 00 00 14 00 02 29 00	//display on
];	
		qcom,mdss-dsi-off-command = [ 	05 01 00 00 32 00 02 28 00
						05 01 00 00 78 00 02 10 00];
		qcom,mdss-dsi-on-command-state = "dsi_lp_mode";
		qcom,mdss-dsi-off-command-state = "dsi_lp_mode";
        //modify by yusen.ke.sz@tcl.com for change esd check mode     
        qcom,esd-check-enabled;
        //qcom,mdss-dsi-panel-status-check-mode = "te_signal_check"; 
        qcom,mdss-dsi-panel-status-command = [
		06 01 00 01 05 00 02 0a 00
		];
		qcom,mdss-dsi-panel-status-command-state = "dsi_lp_mode";
		qcom,mdss-dsi-panel-status-check-mode = "reg_read";
		qcom,mdss-dsi-panel-status-value = <0x9C>;
		//modify end
		qcom,mdss-dsi-h-sync-pulse = <1>;
		qcom,mdss-dsi-traffic-mode = "burst_mode";
		qcom,mdss-dsi-bllp-eof-power-mode;
		qcom,mdss-dsi-bllp-power-mode;

		qcom,mdss-dsi-lane-0-state;
		qcom,mdss-dsi-lane-1-state;
		qcom,mdss-dsi-lane-2-state;
		qcom,mdss-dsi-lane-3-state;
		qcom,mdss-dsi-panel-timings = [87 1C 12 00 42 44 18 20 17 03 04 00];
		qcom,mdss-dsi-t-clk-post = <0x04>;
		qcom,mdss-dsi-t-clk-pre = <0x1B>;
		qcom,mdss-dsi-bl-min-level = <1>;
		qcom,mdss-dsi-bl-max-level = <255>;
		qcom,mdss-dsi-post-init-delay = <4>;
                /*Before reset, beginning LP11*/
        qcom,mdss-dsi-lp11-init;
		qcom,mdss-dsi-init-delay-us = <50000>;
               
		qcom,mdss-dsi-dma-trigger = "trigger_sw";
		qcom,mdss-dsi-mdp-trigger = "none";
		qcom,mdss-dsi-bl-pmic-control-type = "bl_ctrl_gpio";
		qcom,mdss-dsi-reset-sequence = <1 10>, <0 10>, <1 120>;
		//add by yusen.ke.sz@tcl.com for fix Screen size error(display tester APK)
		qcom,mdss-pan-physical-width-dimension = <69>;
		qcom,mdss-pan-physical-height-dimension = <120>;
		//add end

	};
};

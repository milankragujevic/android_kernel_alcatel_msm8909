/* Copyright (c) 2014, The Linux Foundation. All rights reserved.
 *
 * This program is free software; you can redistribute it and/or modify
 * it under the terms of the GNU General Public License version 2 and
 * only version 2 as published by the Free Software Foundation.
 *
 * This program is distributed in the hope that it will be useful,
 * but WITHOUT ANY WARRANTY; without even the implied warranty of
 * MERCHANTABILITY or FITNESS FOR A PARTICULAR PURPOSE.  See the
 * GNU General Public License for more details.
 */

/*---------------------------------------------------------------------------
 * This file is autogenerated file using gcdb parser. Please do not edit it.
 * Update input XML file to add a new entry or update variable in this file
 * VERSION = "1.0"
 *---------------------------------------------------------------------------*/
&mdss_mdp {//modify by yusen.ke.sz@tcl.com at 20160106 for update lcd para
	dsi_ili9881c_djn_hd_vid: qcom,mdss_dsi_ili9881c_djn_hd_video {
		qcom,mdss-dsi-panel-name = "ili9881c djn hd video mode dsi panel[20160116]";
		qcom,mdss-dsi-panel-controller = <&mdss_dsi0>;
		qcom,mdss-dsi-panel-type = "dsi_video_mode";
		qcom,mdss-dsi-panel-destination = "display_1";
		qcom,mdss-dsi-panel-framerate = <60>;
		qcom,mdss-dsi-virtual-channel-id = <0>;
		qcom,mdss-dsi-stream = <0>;
		qcom,mdss-dsi-panel-width = <720>;
		qcom,mdss-dsi-panel-height = <1280>;
		qcom,mdss-dsi-h-front-porch = <108>;
		qcom,mdss-dsi-h-back-porch = <180>;
		qcom,mdss-dsi-h-pulse-width = <8>;
		qcom,mdss-dsi-h-sync-skew = <0>;
                qcom,mdss-dsi-v-front-porch = <25>;
		qcom,mdss-dsi-v-back-porch = <25>;
		qcom,mdss-dsi-v-pulse-width = <2>;
		qcom,mdss-dsi-h-left-border = <0>;
		qcom,mdss-dsi-h-right-border = <0>;
		qcom,mdss-dsi-v-top-border = <0>;
		qcom,mdss-dsi-v-bottom-border = <0>;
		qcom,mdss-dsi-bpp = <24>;
		qcom,mdss-dsi-underflow-color = <0xff>;
		qcom,mdss-dsi-border-color = <0>;
		qcom,mdss-dsi-on-command = [
			39 01 00 00 00 00 04 FF 98 81 03
39 01 00 00 00 00 02 01 00
39 01 00 00 00 00 02 02 00
39 01 00 00 00 00 02 03 53
39 01 00 00 00 00 02 04 13
39 01 00 00 00 00 02 05 13
39 01 00 00 00 00 02 06 06
39 01 00 00 00 00 02 07 00
39 01 00 00 00 00 02 08 04
39 01 00 00 00 00 02 09 00
39 01 00 00 00 00 02 0a 00
39 01 00 00 00 00 02 0b 00
39 01 00 00 00 00 02 0c 00
39 01 00 00 00 00 02 0d 00
39 01 00 00 00 00 02 0e 00
39 01 00 00 00 00 02 0f 00
39 01 00 00 00 00 02 10 00
39 01 00 00 00 00 02 11 00
39 01 00 00 00 00 02 12 00
39 01 00 00 00 00 02 13 00
39 01 00 00 00 00 02 14 00
39 01 00 00 00 00 02 15 00
39 01 00 00 00 00 02 16 00 
39 01 00 00 00 00 02 17 00 
39 01 00 00 00 00 02 18 00
39 01 00 00 00 00 02 19 00
39 01 00 00 00 00 02 1a 00
39 01 00 00 00 00 02 1b 00
39 01 00 00 00 00 02 1c 00
39 01 00 00 00 00 02 1d 00
39 01 00 00 00 00 02 1e C0
39 01 00 00 00 00 02 1f 80
39 01 00 00 00 00 02 20 04
39 01 00 00 00 00 02 21 0B
39 01 00 00 00 00 02 22 00
39 01 00 00 00 00 02 23 00
39 01 00 00 00 00 02 24 00
39 01 00 00 00 00 02 25 00
39 01 00 00 00 00 02 26 00
39 01 00 00 00 00 02 27 00
39 01 00 00 00 00 02 28 55
39 01 00 00 00 00 02 29 03
39 01 00 00 00 00 02 2a 00
39 01 00 00 00 00 02 2b 00
39 01 00 00 00 00 02 2c 00
39 01 00 00 00 00 02 2d 00
39 01 00 00 00 00 02 2e 00
39 01 00 00 00 00 02 2f 00
39 01 00 00 00 00 02 30 00
39 01 00 00 00 00 02 31 00
39 01 00 00 00 00 02 32 00
39 01 00 00 00 00 02 33 00
39 01 00 00 00 00 02 34 04
39 01 00 00 00 00 02 35 05  //
39 01 00 00 00 00 02 36 05
39 01 00 00 00 00 02 37 00
39 01 00 00 00 00 02 38 3c
39 01 00 00 00 00 02 39 00
39 01 00 00 00 00 02 3a 40 
39 01 00 00 00 00 02 3b 40
39 01 00 00 00 00 02 3c 00
39 01 00 00 00 00 02 3d 00
39 01 00 00 00 00 02 3e 00
39 01 00 00 00 00 02 3f 00
39 01 00 00 00 00 02 40 00
39 01 00 00 00 00 02 41 00
39 01 00 00 00 00 02 42 00
39 01 00 00 00 00 02 43 00
39 01 00 00 00 00 02 44 00
39 01 00 00 00 00 02 50 01
39 01 00 00 00 00 02 51 23
39 01 00 00 00 00 02 52 45
39 01 00 00 00 00 02 53 67
39 01 00 00 00 00 02 54 89
39 01 00 00 00 00 02 55 ab
39 01 00 00 00 00 02 56 01
39 01 00 00 00 00 02 57 23
39 01 00 00 00 00 02 58 45
39 01 00 00 00 00 02 59 67
39 01 00 00 00 00 02 5a 89
39 01 00 00 00 00 02 5b ab
39 01 00 00 00 00 02 5c cd
39 01 00 00 00 00 02 5d ef
39 01 00 00 00 00 02 5e 01
39 01 00 00 00 00 02 5f 14
39 01 00 00 00 00 02 60 15
39 01 00 00 00 00 02 61 0C
39 01 00 00 00 00 02 62 0D
39 01 00 00 00 00 02 63 0E
39 01 00 00 00 00 02 64 0F
39 01 00 00 00 00 02 65 10
39 01 00 00 00 00 02 66 11
39 01 00 00 00 00 02 67 08
39 01 00 00 00 00 02 68 02
39 01 00 00 00 00 02 69 0A
39 01 00 00 00 00 02 6a 02
39 01 00 00 00 00 02 6b 02
39 01 00 00 00 00 02 6c 02
39 01 00 00 00 00 02 6d 02
39 01 00 00 00 00 02 6e 02
39 01 00 00 00 00 02 6f 02
39 01 00 00 00 00 02 70 02
39 01 00 00 00 00 02 71 02
39 01 00 00 00 00 02 72 06
39 01 00 00 00 00 02 73 02
39 01 00 00 00 00 02 74 02
39 01 00 00 00 00 02 75 14
39 01 00 00 00 00 02 76 15
39 01 00 00 00 00 02 77 11
39 01 00 00 00 00 02 78 10
39 01 00 00 00 00 02 79 0F
39 01 00 00 00 00 02 7a 0E
39 01 00 00 00 00 02 7b 0D
39 01 00 00 00 00 02 7c 0C
39 01 00 00 00 00 02 7d 06
39 01 00 00 00 00 02 7e 02
39 01 00 00 00 00 02 7f 0A
39 01 00 00 00 00 02 80 02
39 01 00 00 00 00 02 81 02
39 01 00 00 00 00 02 82 02
39 01 00 00 00 00 02 83 02
39 01 00 00 00 00 02 84 02
39 01 00 00 00 00 02 85 02
39 01 00 00 00 00 02 86 02
39 01 00 00 00 00 02 87 02
39 01 00 00 00 00 02 88 08
39 01 00 00 00 00 02 89 02
39 01 00 00 00 00 02 8A 02
39 01 00 00 00 00 04 FF 98 81 04
39 01 00 00 00 00 02 00 80 //00 FOR 3LANE   80 FOR 4LANE
39 01 00 00 00 00 02 6C 15                //Set VCORE voltage =1.5V
39 01 00 00 00 00 02 6E 3B                  //di_pwr_reg=0 for power mode 2A //VGH clamp 18V
39 01 00 00 00 00 02 6F 53                // reg vcl + pumping ratio VGH=3x VGL=-2x
39 01 00 00 00 00 02 3A A4                //POWER SAVING
39 01 00 00 00 00 02 8D 15               //VGL clamp -10V
39 01 00 00 00 00 02 87 BA               //ESD               
39 01 00 00 00 00 02 26 76            
39 01 00 00 00 00 02 B2 D1
39 01 00 00 00 00 02 88 0B
39 01 00 00 00 00 04 FF 98 81 01
39 01 00 00 00 00 02 22 0A               //BGR  SS
39 01 00 00 00 00 02 31 00               //column inversion
39 01 00 00 00 00 02 53 95              //VCOM1
39 01 00 00 00 00 02 55 90               //VCOM2
39 01 00 00 00 00 02 50 a7               // VREG1OUT=4.7V   C0=5.0
39 01 00 00 00 00 02 51 a7               // VREG2OUT=-4.7V
39 01 00 00 00 00 02 60 14               //SDT
39 01 00 00 00 00 02 A0 08               //VP255 Gamma P
39 01 00 00 00 00 02 A1 22               //VP251
39 01 00 00 00 00 02 A2 31               //VP247
39 01 00 00 00 00 02 A3 13               //VP243
39 01 00 00 00 00 02 A4 17               //VP239
39 01 00 00 00 00 02 A5 2A               //VP231
39 01 00 00 00 00 02 A6 1E               //VP219
39 01 00 00 00 00 02 A7 20               //VP203
39 01 00 00 00 00 02 A8 94              //VP175
39 01 00 00 00 00 02 A9 1C               //VP144
39 01 00 00 00 00 02 AA 29               //VP111
39 01 00 00 00 00 02 AB 7D               //VP80
39 01 00 00 00 00 02 AC 19               //VP52
39 01 00 00 00 00 02 AD 18               //VP36
39 01 00 00 00 00 02 AE 4C              //VP24
39 01 00 00 00 00 02 AF 20               //VP16 
39 01 00 00 00 00 02 B0 27              //VP12
39 01 00 00 00 00 02 B1 4D               //VP8
39 01 00 00 00 00 02 B2 5C               //VP4
39 01 00 00 00 00 02 B3 2C               //VP0
39 01 00 00 00 00 02 C0 08               //VN255 GAMMA N
39 01 00 00 00 00 02 C1 22               //VN251
39 01 00 00 00 00 02 C2 30               //VN247
39 01 00 00 00 00 02 C3 12               //VN243
39 01 00 00 00 00 02 C4 17               //VN239
39 01 00 00 00 00 02 C5 29               //VN231
39 01 00 00 00 00 02 C6 1E               //VN219
39 01 00 00 00 00 02 C7 20               //VN203
39 01 00 00 00 00 02 C8 93               //VN175
39 01 00 00 00 00 02 C9 1C               //VN144
39 01 00 00 00 00 02 CA 29               //VN111
39 01 00 00 00 00 02 CB 7D               //VN80
39 01 00 00 00 00 02 CC 19               //VN52
39 01 00 00 00 00 02 CD 18               //VN36
39 01 00 00 00 00 02 CE 4C               //VN24
39 01 00 00 00 00 02 CF 20               //VN16
39 01 00 00 00 00 02 D0 27               //VN12
39 01 00 00 00 00 02 D1 4D               //VN8
39 01 00 00 00 00 02 D2 5D               //VN4
39 01 00 00 00 00 02 D3 2C               //VN0
39 01 00 00 00 00 04 FF 98 81 00   
05 01 00 00 00 00 02 35 00               //TE on;
05 01 00 00 78 00 02 11 00// Sleep Out
05 01 00 00 14 00 02 29 00//Display on
];	//TE on;
		qcom,mdss-dsi-off-command = [ 
		05 01 00 00 14 00 02 28 00
		05 01 00 00 78 00 02 10 00
		];
		qcom,mdss-dsi-on-command-state = "dsi_lp_mode";
		qcom,mdss-dsi-off-command-state = "dsi_lp_mode";

        /*
		LCD read register Check start
		qcom,esd-check-enabled;
		qcom,mdss-dsi-panel-status-command = [06 01 00 01 05 00 01 09];           //send command
		qcom,mdss-dsi-panel-status-command_for_one = [14 01 00 01 05 00 01 d9];   //send command one
		qcom,mdss-dsi-panel-status-command-state = "dsi_hs_mode";                 //user to lp mode read
		qcom,mdss-dsi-panel-status-check-mode = "reg_read_hx8394d";               //"reg_read_hx8394d";
		qcom,mdss-dsi-panel-status-value = <0x81 0x73 0x06>;                      //register return value1
		qcom,mdss-dsi-panel-status-value_for_one = <0x80>;                        //register return value2
		*/
		/*LCD read register Check End*/
		//add LCD TE check mode for pixi3-55 by SH richard.liang 2015-05-21
		//qcom,esd-check-enabled;
		//qcom,mdss-dsi-panel-status-check-mode = "te_signal_check"; 
		//end richard.liang
		qcom,mdss-dsi-h-sync-pulse = <1>;
		qcom,mdss-dsi-traffic-mode = "burst_mode";
		qcom,mdss-dsi-bllp-eof-power-mode;
		qcom,mdss-dsi-bllp-power-mode;
		qcom,mdss-dsi-lane-0-state;
		qcom,mdss-dsi-lane-1-state;
		qcom,mdss-dsi-lane-2-state;
		qcom,mdss-dsi-lane-3-state;
		qcom,mdss-dsi-panel-timings = [82 1E 14 00 42 46 18 80 16 03 04 00];
		qcom,mdss-dsi-t-clk-post = <0x04>;
		qcom,mdss-dsi-t-clk-pre = <0x1B>;
		qcom,mdss-dsi-bl-min-level = <1>;
		qcom,mdss-dsi-bl-max-level = <255>;
        /*Before reset, beginning LP11*/
        qcom,mdss-dsi-lp11-init;
		qcom,mdss-dsi-init-delay-us = <50000>;
               
		qcom,mdss-dsi-dma-trigger = "trigger_sw";
		qcom,mdss-dsi-mdp-trigger = "none";
		qcom,mdss-dsi-bl-pmic-control-type = "bl_ctrl_pwm";
		//add by yusen.ke.sz@tcl.com at 20160108 for enable cabl
		qcom,mdss-dsi-bl-pmic-pwm-frequency = <33>;//modify by yusen.ke.sz@tcl.com at 20160202 for fix backlight can not adjust
        qcom,mdss-dsi-bl-pmic-bank-select = <0>;
		//add end
		qcom,mdss-dsi-reset-sequence = <1 10>, <0 10>, <1 120>;
		qcom,mdss-pan-physical-width-dimension = <62>; // add width for display test
		qcom,mdss-pan-physical-height-dimension = <110>;// add height for display test
		//add by yusen.ke.sz@tcl.com at 20151217 for esd check 
		qcom,esd-check-enabled;
		qcom,mdss-dsi-panel-status-command = [
		06 01 00 01 05 00 02 0a 00
		];
		qcom,mdss-dsi-panel-status-command-state = "dsi_lp_mode";
		qcom,mdss-dsi-panel-status-check-mode = "reg_read";
		qcom,mdss-dsi-panel-status-value = <0x9C>;
		//add end
		
	};
};

/* Copyright (c) 2014-2015, The Linux Foundation. All rights reserved.
 *
 * This program is free software; you can redistribute it and/or modify
 * it under the terms of the GNU General Public License version 2 and
 * only version 2 as published by the Free Software Foundation.
 *
 * This program is distributed in the hope that it will be useful,
 * but WITHOUT ANY WARRANTY; without even the implied warranty of
 * MERCHANTABILITY or FITNESS FOR A PARTICULAR PURPOSE.  See the
 * GNU General Public License for more details.
 */

/*---------------------------------------------------------------------------
 * This file is autogenerated file using gcdb parser. Please do not edit it.
 * Update input XML file to add a new entry or update variable in this file
 * VERSION = "1.0"
 *---------------------------------------------------------------------------*/
&mdss_mdp {
	dsi_ili9806e_fwvga_video: qcom,mdss_dsi_ili9806e_fwvga_video_pixi445_tf {
		qcom,mdss-dsi-panel-name = "ili9806e fwvga video mode dsi panel";
		qcom,mdss-dsi-panel-controller = <&mdss_dsi0>;
		qcom,mdss-dsi-panel-type = "dsi_video_mode";
		qcom,mdss-dsi-panel-destination = "display_1";
		qcom,mdss-dsi-panel-framerate = <60>;
		qcom,mdss-dsi-virtual-channel-id = <0>;
		qcom,mdss-dsi-stream = <0>;
		qcom,mdss-dsi-panel-width = <480>;
		qcom,mdss-dsi-panel-height = <854>;
		qcom,mdss-dsi-h-front-porch = <80>;
		qcom,mdss-dsi-h-back-porch = <80>;
		qcom,mdss-dsi-h-pulse-width = <10>;
		qcom,mdss-dsi-h-sync-skew = <0>;
		qcom,mdss-dsi-v-back-porch = <14>;
		qcom,mdss-dsi-v-front-porch = <20>;
		qcom,mdss-dsi-v-pulse-width = <4>;
		qcom,mdss-dsi-h-left-border = <0>;
		qcom,mdss-dsi-h-right-border = <0>;
		qcom,mdss-dsi-v-top-border = <0>;
		qcom,mdss-dsi-v-bottom-border = <0>;
		qcom,mdss-dsi-bpp = <24>;
		qcom,mdss-dsi-color-order = "rgb_swap_rgb";
		qcom,mdss-dsi-underflow-color = <0xff>;
		qcom,mdss-dsi-border-color = <0>;

		qcom,mdss-dsi-on-command = [
			39 01 00 00 00 00 06 FF FF 98 06 04 01			// Change to Page 1
			39 01 00 00 00 00 02 08 10				// output SDA
			39 01 00 00 00 00 02 21 01				// DE = 1 Active
			39 01 00 00 00 00 02 30 01	 			// 480 X 854
			39 01 00 00 00 00 02 31 00				// 2-dot Inversion
			39 01 00 00 00 00 02 40 18				// DDVDH/DDVDL 
			39 01 00 00 00 00 02 41 77				// DDVDH/DDVDL CP
			39 01 00 00 00 00 02 42 02				// VGH/VGL
			39 01 00 00 00 00 02 43 09				// VGH_CP_OFF
			39 01 00 00 00 00 02 44 06				// VGL_CP_OFF
			39 01 00 00 00 00 02 45 06

			39 01 00 00 00 00 02 50 78	 			// VGMP
			39 01 00 00 00 00 02 51 78				// VGMN
			39 01 00 00 00 00 02 52 00				// Flicker
			39 01 00 00 00 00 02 53 54				// flicker
			39 01 00 00 00 00 02 57 50				// flicker
			39 01 00 00 00 00 02 60 07				// SDTI
			39 01 00 00 00 00 02 61 00				// CRTI
			39 01 00 00 00 00 02 62 07				// 2015.9.9 change EQ register     // EQTI
			39 01 00 00 00 00 02 63 00	    			// PCTI

			/*gamma setting */
			39 01 00 00 00 00 06 FF FF 98 06 04 01
			39 01 00 00 00 00 02 A0 00				// Gamma 0 
			39 01 00 00 00 00 02 A1 08				// Gamma 4
			39 01 00 00 00 00 02 A2 13				// Gamma 8
			39 01 00 00 00 00 02 A3 0F				// Gamma 16
			39 01 00 00 00 00 02 A4 09				// Gamma 24
			39 01 00 00 00 00 02 A5 16				// Gamma 52
			39 01 00 00 00 00 02 A6 0B				// Gamma 80
			39 01 00 00 00 00 02 A7 08				// Gamma 108
			39 01 00 00 00 00 02 A8 04				// Gamma 147
			39 01 00 00 00 00 02 A9 0B				// Gamma 175
			39 01 00 00 00 00 02 AA 06				// Gamma 203
			39 01 00 00 00 00 02 AB 08				// Gamma 231
			39 01 00 00 00 00 02 AC 0D				// Gamma 239
			39 01 00 00 00 00 02 AD 36				// Gamma 247
			39 01 00 00 00 00 02 AE 27				// Gamma 251
			39 01 00 00 00 00 02 AF 00				// Gamma 255
			/*gamma setting Nagitive*/
			39 01 00 00 00 00 02 C0 00				// Gamma 0
			39 01 00 00 00 00 02 C1 06				// Gamma 4
			39 01 00 00 00 00 02 C2 0F				// Gamma 8
			39 01 00 00 00 00 02 C3 0F				// Gamma 16
			39 01 00 00 00 00 02 C4 08				// Gamma 24
			39 01 00 00 00 00 02 C5 16				// Gamma 52
			39 01 00 00 00 00 02 C6 05				// Gamma 80
			39 01 00 00 00 00 02 C7 04				// Gamma 108
			39 01 00 00 00 00 02 C8 04				// Gamma 147
			39 01 00 00 00 00 02 C9 08				// Gamma 175
			39 01 00 00 00 00 02 CA 06				// Gamma 203
			39 01 00 00 00 00 02 CB 06				// Gamma 231
			39 01 00 00 00 00 02 CC 08				// Gamma 239
			39 01 00 00 00 00 02 CD 25				// Gamma 247
			39 01 00 00 00 00 02 CE 27				// Gamma 251
			39 01 00 00 00 00 02 CF 00				// Gamma 255

			39 01 00 00 00 00 06 FF FF 98 06 04 06
                        39 01 00 00 00 00 02 00 23
			39 01 00 00 00 00 02 01 0A
			39 01 00 00 00 00 02 02 00
			39 01 00 00 00 00 02 03 04
			39 01 00 00 00 00 02 04 01
			39 01 00 00 00 00 02 05 01
			39 01 00 00 00 00 02 06 80
			39 01 00 00 00 00 02 07 08
			39 01 00 00 00 00 02 08 09
			39 01 00 00 00 00 02 09 00
			39 01 00 00 00 00 02 0A 00
			39 01 00 00 00 00 02 0B 00
			39 01 00 00 00 00 02 0C 01
			39 01 00 00 00 00 02 0D 01
			39 01 00 00 00 00 02 0E 00
			39 01 00 00 00 00 02 0F 00
			39 01 00 00 00 00 02 10 7E
			39 01 00 00 00 00 02 11 F3
			39 01 00 00 00 00 02 12 04
			39 01 00 00 00 00 02 13 00
			39 01 00 00 00 00 02 14 00
			39 01 00 00 00 00 02 15 C0
			39 01 00 00 00 00 02 16 08
			39 01 00 00 00 00 02 17 00
			39 01 00 00 00 00 02 18 00
			39 01 00 00 00 00 02 19 00
			39 01 00 00 00 00 02 1A 00
			39 01 00 00 00 00 02 1B 00
			39 01 00 00 00 00 02 1C 00
			39 01 00 00 00 00 02 1D 00

                        39 01 00 00 00 00 02 20 01
                        39 01 00 00 00 00 02 21 23
                        39 01 00 00 00 00 02 22 45
                        39 01 00 00 00 00 02 23 67
                        39 01 00 00 00 00 02 24 01
                        39 01 00 00 00 00 02 25 23
                        39 01 00 00 00 00 02 26 45
                        39 01 00 00 00 00 02 27 67

			39 01 00 00 00 00 02 30 13
			39 01 00 00 00 00 02 31 22
			39 01 00 00 00 00 02 32 22
			39 01 00 00 00 00 02 33 96
			39 01 00 00 00 00 02 34 DA
			39 01 00 00 00 00 02 35 AB
			39 01 00 00 00 00 02 36 BC
			39 01 00 00 00 00 02 37 CD
			39 01 00 00 00 00 02 38 22
			39 01 00 00 00 00 02 39 FE
			39 01 00 00 00 00 02 3A EF
			39 01 00 00 00 00 02 3B 22
			39 01 00 00 00 00 02 3C 68
			39 01 00 00 00 00 02 3D 22
			39 01 00 00 00 00 02 3E 22
			39 01 00 00 00 00 02 3F 89
			39 01 00 00 00 00 02 40 22
			39 01 00 00 00 00 02 52 10
			39 01 00 00 00 00 02 53 12
			//39 01 00 00 00 00 02 54 13
			//39 01 00 00 00 00 02 58 A7

			39 01 00 00 00 00 06 FF FF 98 06 04 07
			39 01 00 00 00 00 02 02 77
			39 01 00 00 00 00 02 E1 79
			39 01 00 00 00 00 02 17 32
			//39 01 00 00 00 00 02 02 77
			39 01 00 00 00 00 02 68 01
			39 01 00 00 00 00 02 06 13

			39 01 00 00 00 00 06 FF FF 98 06 04 00
                        05 01 00 00 78 00 02 11 00
                        05 01 00 00 1e 00 02 29 00
			];
		qcom,mdss-dsi-off-command = [05 01 00 00 14 00 02 28 00
					     05 01 00 00 78 00 02 10 00];
		qcom,mdss-dsi-on-command-state = "dsi_lp_mode";
		qcom,mdss-dsi-off-command-state = "dsi_hs_mode";
		qcom,mdss-dsi-h-sync-pulse = <1>;
		qcom,mdss-dsi-traffic-mode = "burst_mode";
		qcom,mdss-dsi-lane-map = "lane_map_0123";
		qcom,mdss-dsi-bllp-eof-power-mode;
		qcom,mdss-dsi-bllp-power-mode;
		qcom,mdss-dsi-lane-0-state;
		qcom,mdss-dsi-lane-1-state;
		/*add clk and data per line goes to lp11*/
		qcom,mdss-dsi-hfp-power-mode;
		qcom,mdss-dsi-hbp-power-mode;
		qcom,mdss-dsi-hsa-power-mode;
		/*add clk and data per line goes to lp11*/
		qcom,mdss-dsi-panel-timings = [7A 1A 12 00 3E 42 16 1E 14 03 04 00];
		qcom,mdss-dsi-t-clk-post = <0x04>;
		qcom,mdss-dsi-t-clk-pre = <0x1A>;
		qcom,mdss-dsi-bl-min-level = <1>;
		qcom,mdss-dsi-bl-max-level = <255>;
		qcom,mdss-dsi-lp11-init;
		//qcom,mdss-dsi-init-delay-us = <50000>;
		qcom,mdss-dsi-bl-pmic-control-type = "bl_ctrl_gpio";
		//qcom,mdss-dsi-bl-pmic-pwm-frequency = <33>;
		//qcom,mdss-dsi-bl-pmic-bank-select = <0>;
		//qcom,mdss-dsi-pwm-gpio = <&pm8909_mpps 2 0>;
		qcom,cont-splash-enabled;

		qcom,mdss-dsi-dma-trigger = "trigger_sw";
		qcom,mdss-dsi-mdp-trigger = "none";
		qcom,mdss-dsi-reset-sequence = <1 10>, <0 10>, <1 20>;
		qcom,mdss-dsi-post-init-delay = <2>;
		qcom,mdss-pan-physical-width-dimension = <0>;
		qcom,mdss-pan-physical-height-dimension = <0>;
	};
};

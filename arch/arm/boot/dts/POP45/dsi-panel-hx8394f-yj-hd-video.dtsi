/* Copyright (c) 2014, The Linux Foundation. All rights reserved.
 *
 * This program is free software; you can redistribute it and/or modify
 * it under the terms of the GNU General Public License version 2 and
 * only version 2 as published by the Free Software Foundation.
 *
 * This program is distributed in the hope that it will be useful,
 * but WITHOUT ANY WARRANTY; without even the implied warranty of
 * MERCHANTABILITY or FITNESS FOR A PARTICULAR PURPOSE.  See the
 * GNU General Public License for more details.
 */

/*---------------------------------------------------------------------------
 * This file is autogenerated file using gcdb parser. Please do not edit it.
 * Update input XML file to add a new entry or update variable in this file
 * VERSION = "1.0"
 *---------------------------------------------------------------------------*/
&mdss_mdp {
	dsi_hx8394f_yj_hd_vid: qcom,mdss_dsi_hx8394f_yj_hd_video {
		qcom,mdss-dsi-panel-name = "hx8394f yj hd video mode dsi panel[20160113]";
		qcom,mdss-dsi-panel-controller = <&mdss_dsi0>;
		qcom,mdss-dsi-panel-type = "dsi_video_mode";
		qcom,mdss-dsi-panel-destination = "display_1";
		qcom,mdss-dsi-panel-framerate = <60>;
		qcom,mdss-dsi-virtual-channel-id = <0>;
		qcom,mdss-dsi-stream = <0>;
		qcom,mdss-dsi-panel-width = <720>;
		qcom,mdss-dsi-panel-height = <1280>;
		qcom,mdss-dsi-h-front-porch = <90>;
		qcom,mdss-dsi-h-back-porch = <90>;
		qcom,mdss-dsi-h-pulse-width = <36>;
		qcom,mdss-dsi-h-sync-skew = <0>;
                qcom,mdss-dsi-v-front-porch = <15>;
		qcom,mdss-dsi-v-back-porch = <12>;
		qcom,mdss-dsi-v-pulse-width = <4>;
		qcom,mdss-dsi-h-left-border = <0>;
		qcom,mdss-dsi-h-right-border = <0>;
		qcom,mdss-dsi-v-top-border = <0>;
		qcom,mdss-dsi-v-bottom-border = <0>;
		qcom,mdss-dsi-bpp = <24>;
		qcom,mdss-dsi-underflow-color = <0xff>;
		qcom,mdss-dsi-border-color = <0>;
		qcom,mdss-dsi-on-command = [
29 01 00 00 00 00 04 B9 FF 83 94
29 01 00 00 00 00 0B B1 70 13 73 09 31 44 71 31 55 2F
29 01 00 00 00 00 07 BA 63 03 68 6B B2 C0
29 01 00 00 00 00 02 D2 66
29 01 00 00 00 00 06 B2 00 80 64 10 07
29 01 00 00 00 00 16 B4 01 74 01 74 01 74 01 0C 86 75 00 3F 01 74 01 74 01 74 01 0C 86
29 01 00 00 00 00 22	D3 00 00 07 07 40 1E 08 00 32 10 08 00 08 54 15 10 05 04 02 12 10 05 07 23 23 0C 0C 27 10 07 07 10 40
29 01 00 00 00 00 2d D5 19 19 18 18 1B 1B 1A 1A 04 05 06 07 00 01 02 03 20 21 18 18 22 23 18 18 18 18 18 18 18 18 18 18 18 18 18 18 18 18 18 18 18 18 18 18
29 01 00 00 00 00 2d D6 18 18 19 19 1B 1B 1A 1A 03 02 01 00 07 06 05 04 23 22 18 18 21 20 18 18 18 18 18 18 18 18 18 18 18 18 18 18 18 18 18 18 18 18 18 18
29 01 00 00 00 00 3b E0 00 01 07 0A 0C 0F 11 0F 1E 2D 3F 3F 4A 5F 66 6C 7D 85 85 97 AC 56 57 5C 62 66 78 7F 7F 00 01 07 0A 0C 0F 10 0E 1E 2D 3F 3F 4A 5F 67 6D 7D 85 85 98 AC 56 56 5B 62 67 78 7F 7F
29 01 00 00 00 00 02 CC 0B
29 01 00 00 00 00 03 C0 1F 31
29 01 00 00 00 00 03 B6 A8 A8
29 01 00 00 00 00 02 D4 02
29 01 00 00 00 00 02 BD 01
29 01 00 00 00 00 02 B1 00
29 01 00 00 00 00 02 BD 00
29 01 00 00 00 00 08 BF 40 81 50 00 1A FC 01
			//29 01 00 00 00 00 02 36 02//add by yusen.ke.sz@tcl.com for debug
			05 01 00 00 78 00 02 11 00
29 01 00 00 00 00 0D B2 00 80 64 10 07 2F 00 00 00 00 C0 18
			05 01 00 00 10 00 02 29 00 ];
		qcom,mdss-dsi-off-command = [ 05 01 00 00 10 00 02 28 00
					      05 01 00 00 78 00 02 10 00];
		qcom,mdss-dsi-on-command-state = "dsi_lp_mode";
		qcom,mdss-dsi-off-command-state = "dsi_hs_mode";
                 //modify by yusen.ke.sz@tcl.com for change esd check mode     
        	//qcom,esd-check-enabled;
        	qcom,mdss-dsi-panel-status-command = [
			06 01 00 01 05 00 02 0a 00
		];
		qcom,mdss-dsi-panel-status-command-state = "dsi_lp_mode";
		qcom,mdss-dsi-panel-status-check-mode = "reg_read";
		qcom,mdss-dsi-panel-status-value = <0x9C>;
		//modify end
		qcom,mdss-dsi-h-sync-pulse = <1>;
		qcom,mdss-dsi-traffic-mode = "burst_mode";
		qcom,mdss-dsi-bllp-eof-power-mode;
		qcom,mdss-dsi-bllp-power-mode;
		qcom,mdss-dsi-lane-0-state;
		qcom,mdss-dsi-lane-1-state;
		qcom,mdss-dsi-lane-2-state;
		qcom,mdss-dsi-lane-3-state;
		qcom,mdss-dsi-panel-timings = [82 1C 12 00 40 42 16 1E 14 03 04 00];
		qcom,mdss-dsi-t-clk-post = <0x04>;
		qcom,mdss-dsi-t-clk-pre = <0x1B>;
		qcom,mdss-dsi-bl-min-level = <1>;
		qcom,mdss-dsi-bl-max-level = <255>;
                /*Before reset, beginning LP11*/
                qcom,mdss-dsi-lp11-init;
		qcom,mdss-dsi-init-delay-us = <50000>;
                /*Before reset, beginning LP11*/
                qcom,mdss-dsi-bl-pmic-control-type = "bl_ctrl_pwm";
		//add by yusen.ke.sz@tcl.com at 20160108 for enable cabl
		qcom,mdss-dsi-bl-pmic-pwm-frequency = <255>;
        qcom,mdss-dsi-bl-pmic-bank-select = <0>;
		//add end
		qcom,mdss-dsi-dma-trigger = "trigger_sw";
		qcom,mdss-dsi-mdp-trigger = "none";		
		qcom,mdss-dsi-reset-sequence = <1 10>, <0 10>, <1 120>;
		qcom,mdss-pan-physical-width-dimension = <62>;
		qcom,mdss-pan-physical-height-dimension = <110>;

	};
};

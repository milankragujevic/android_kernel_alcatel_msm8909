/* Copyright (c) 2014, The Linux Foundation. All rights reserved.
 *
 * This program is free software; you can redistribute it and/or modify
 * it under the terms of the GNU General Public License version 2 and
 * only version 2 as published by the Free Software Foundation.
 *
 * This program is distributed in the hope that it will be useful,
 * but WITHOUT ANY WARRANTY; without even the implied warranty of
 * MERCHANTABILITY or FITNESS FOR A PARTICULAR PURPOSE.  See the
 * GNU General Public License for more details.
 */

&mdss_mdp {
	dsi_otm1287a_byd_720_vid: qcom,mdss_dsi_otm1287a_byd_720p_video {
		qcom,mdss-dsi-panel-name = "otm1287a byd 720p video mode dsi panel";
		qcom,mdss-dsi-panel-controller = <&mdss_dsi0>;
		qcom,mdss-dsi-panel-type = "dsi_video_mode";
		qcom,mdss-dsi-panel-destination = "display_1";
		qcom,mdss-dsi-panel-framerate = <60>;
		qcom,mdss-dsi-virtual-channel-id = <0>;
		qcom,mdss-dsi-stream = <0>;
		qcom,mdss-dsi-panel-width = <720>;
		qcom,mdss-dsi-panel-height = <1280>;
		qcom,mdss-dsi-h-front-porch = <64>;
		qcom,mdss-dsi-h-back-porch = <64>;
		qcom,mdss-dsi-h-pulse-width = <8>;
		qcom,mdss-dsi-h-sync-skew = <0>;
        qcom,mdss-dsi-v-front-porch = <16>;
		qcom,mdss-dsi-v-back-porch = <14>;
		qcom,mdss-dsi-v-pulse-width = <4>;
		qcom,mdss-dsi-h-left-border = <0>;
		qcom,mdss-dsi-h-right-border = <0>;
		qcom,mdss-dsi-v-top-border = <0>;
		qcom,mdss-dsi-v-bottom-border = <0>;
		qcom,mdss-dsi-bpp = <24>;
		qcom,mdss-dsi-color-order = "rgb_swap_rgb";
		qcom,mdss-dsi-underflow-color = <0xff>;
		qcom,mdss-dsi-border-color = <0>;
		qcom,mdss-dsi-on-command = [
            39 01 00 00 00 00 02 00 00
			39 01 00 00 00 00 04 ff 12 87 01

			39 01 00 00 00 00 02 00 80
			39 01 00 00 00 00 03 ff 12 87

			39 01 00 00 00 00 02 00 92
			39 01 00 00 00 00 03 ff 30 02
			
			39 01 00 00 00 00 02 00 80
			39 01 00 00 00 00 0A c0 00 64 00 10 10 00 64 10 10

			39 01 00 00 00 00 02 00 90
			39 01 00 00 00 00 07 c0 00 5b 00 01 00 04

			39 01 00 00 00 00 02 00 a2
			39 01 00 00 00 00 04 c0 00 02 02

        	39 01 00 00 00 00 02 00 b3
			39 01 00 00 00 00 03 c0 00 55

			39 01 00 00 00 00 02 00 81
			39 01 00 00 00 00 02 c1 55

			39 01 00 00 00 00 02 00 A0
			39 01 00 00 00 00 0F c4 05 10 06 02 05 15 10 05 10 07 02 05 15 10

			39 01 00 00 00 00 02 00 b0
			39 01 00 00 00 00 03 c4 00 00

			39 01 00 00 00 00 02 00 91
			39 01 00 00 00 00 03 c5 46 42

			39 01 00 00 00 00 02 00 00
			39 01 00 00 00 00 03 d8 be be

			39 01 00 00 00 00 02 00 00
			39 01 00 00 00 00 02 d9 58

			39 01 00 00 00 00 02 00 b3
			39 01 00 00 00 00 02 c5 84

			39 01 00 00 00 00 02 00 bb
			39 01 00 00 00 00 02 c5 8a

			39 01 00 00 00 00 02 00 82
			39 01 00 00 00 00 02 C4 0a  

			39 01 00 00 00 00 02 00 c6
			39 01 00 00 00 00 02 b0 03

			39 01 00 00 00 00 02 00 00           
			39 01 00 00 00 00 02 d0 40

			39 01 00 00 00 00 02 00 00          
			39 01 00 00 00 00 03 d1 00 00

			39 01 00 00 00 00 02 00 80
			39 01 00 00 00 00 0c cb 00 00 00 00 00 00 00 00 00 00 00

            39 01 00 00 00 00 02 00 90
			39 01 00 00 00 00 10 cb 00 00 00 00 00 00 00 00 00 00 00 00 00 00 00

			39 01 00 00 00 00 02 00 a0
			39 01 00 00 00 00 10 cb 00 00 00 00 00 00 00 00 00 00 00 00 00 00 00
			
            39 01 00 00 00 00 02 00 b0
			39 01 00 00 00 00 10 cb 00 00 00 00 00 00 00 00 00 00 00 00 00 00 00

            39 01 00 00 00 00 02 00 c0
			39 01 00 00 00 00 10 cb 05 05 05 05 05 05 05 05 05 00 00 00 00 00 00

            39 01 00 00 00 00 02 00 d0
			39 01 00 00 00 00 10 cb 05 00 00 00 00 00 00 05 05 05 05 05 05 05 05

            39 01 00 00 00 00 02 00 e0
			39 01 00 00 00 00 0f cb 05 00 00 00 00 00 00 05 00 00 00 00 00 00

            39 01 00 00 00 00 02 00 f0
			39 01 00 00 00 00 0c cb FF FF FF FF FF FF FF FF FF FF FF

            39 01 00 00 00 00 02 00 80
			39 01 00 00 00 00 10 cc 2E 2D 29 2A 0A 0C 0E 10 02 00 00 00 00 00 00

            39 01 00 00 00 00 02 00 90
			39 01 00 00 00 00 10 cc 04 00 00 00 00 00 00 2E 2D 29 2A 09 0B 0D 0F

            39 01 00 00 00 00 02 00 a0
			39 01 00 00 00 00 0f cc 01 00 00 00 00 00 00 03 00 00 00 00 00 00


            39 01 00 00 00 00 02 00 b0
			39 01 00 00 00 00 10 cc 2D 2E 29 2A 0F 0D 0B 09 03 00 00 00 00 00 00
			
            39 01 00 00 00 00 02 00 c0
			39 01 00 00 00 00 10 cc 01 00 00 00 00 00 00 2D 2E 29 2A 10 0E 0C 0A
			
            39 01 00 00 00 00 02 00 d0
			39 01 00 00 00 00 0f cc 04 00 00 00 00 00 00 02 00 00 00 00 00 00

            39 01 00 00 00 00 02 00 80
			39 01 00 00 00 00 0d ce 8B 03 18 8A 03 18 89 03 18 88 03 18

            39 01 00 00 00 00 02 00 90
			39 01 00 00 00 00 0f ce 34 FD 18 34 FF 18 00 00 00 00 00 00 00 00

            39 01 00 00 00 00 02 00 a0
			39 01 00 00 00 00 0f ce 38 03 05 01 00 18 00 38 02 05 02 00 18 00

            39 01 00 00 00 00 02 00 b0
			39 01 00 00 00 00 0f ce 38 01 05 03 00 18 00 38 00 05 04 00 18 00

            39 01 00 00 00 00 02 00 c0
			39 01 00 00 00 00 0f ce 38 07 04 FD 00 18 00 38 06 04 FE 00 18 00

            39 01 00 00 00 00 02 00 d0
			39 01 00 00 00 00 0f ce 38 05 04 FF 00 18 00 38 04 05 00 00 18 00

            39 01 00 00 00 00 02 00 80
			39 01 00 00 00 00 0f cf 00 00 00 00 00 00 00 00 00 00 00 00 00 00

            39 01 00 00 00 00 02 00 90
			39 01 00 00 00 00 0f cf 00 00 00 00 00 00 00 00 00 00 00 00 00 00

            39 01 00 00 00 00 02 00 a0
			39 01 00 00 00 00 0f cf 00 00 00 00 00 00 00 00 00 00 00 00 00 00

            39 01 00 00 00 00 02 00 b0
			39 01 00 00 00 00 0f cf 00 00 00 00 00 00 00 00 00 00 00 00 00 00

            39 01 00 00 00 00 02 00 c0
			39 01 00 00 00 00 0c cf 3D 02 15 20 00 00 01 80 00 03 35

            39 01 00 00 00 00 02 00 b5
            39 01 00 00 00 00 07 c5 0f 81 ff 0f 81 ff

            39 01 00 00 00 00 02 00 90
			39 01 00 00 00 00 05 f5 02 11 02 15

            39 01 00 00 00 00 02 00 90
			39 01 00 00 00 00 02 c5 50
			39 01 00 00 00 00 02 00 94  
			39 01 00 00 00 00 02 c5 66

			39 01 00 00 00 00 02 00 00
			39 01 00 00 00 00 15 e1 10 1d 29 32 41 4d 4d 75 64 7d 85 6f 7e 57 54 45 36 28 1B 10

			39 01 00 00 00 00 02 00 00
			39 01 00 00 00 00 15 e2 10 1d 29 32 41 4d 4d 75 64 7d 85 6f 7e 57 54 45 36 28 1B 10
/*
			39 01 00 00 00 00 02 00 00
			39 01 00 00 00 00 02 00 00
			39 01 00 00 00 00 04 ff ff ff ff  */

			05 01 00 00 78 00 02 11 00
			05 01 00 00 00 00 02 29 00];
		qcom,mdss-dsi-off-command = [05 01 00 00 32 00 02 28 00
					05 01 00 00 05 00 02 10 00];
		qcom,mdss-dsi-on-command-state = "dsi_lp_mode";
		qcom,mdss-dsi-off-command-state = "dsi_hs_mode";
                qcom,mdss-dsi-panel-status-check-mode = "bta_check";
		qcom,mdss-dsi-h-sync-pulse = <1>;
		qcom,mdss-dsi-traffic-mode = "burst_mode";//"non_burst_sync_pulse";//
		//qcom,mdss-dsi-lane-map = "lane_map_0123";
		qcom,mdss-dsi-bllp-eof-power-mode;
		qcom,mdss-dsi-bllp-power-mode;
		qcom,mdss-dsi-lane-0-state;
		qcom,mdss-dsi-lane-1-state;
		qcom,mdss-dsi-lane-2-state;
		qcom,mdss-dsi-lane-3-state;
		qcom,mdss-dsi-panel-timings = [7b 1A 10 00 3C 40 14 1c 15 03 04 00];
		qcom,mdss-dsi-t-clk-post = <0x04>;
		qcom,mdss-dsi-t-clk-pre = <0x1a>;
		qcom,mdss-dsi-bl-min-level = <1>;
		qcom,mdss-dsi-bl-max-level = <255>;
		//qcom,mdss-dsi-bl-pmic-pwm-frequency = <100>;
		//qcom,mdss-dsi-bl-pmic-bank-select = <0>;
		qcom,mdss-dsi-dma-trigger = "trigger_sw";
		qcom,mdss-dsi-mdp-trigger = "none";
		qcom,mdss-dsi-bl-pmic-control-type = "bl_ctrl_pwm";
        //qcom,mdss-dsi-lp11-init;
		//qcom,mdss-dsi-init-delay-us = <50000>;
		qcom,mdss-dsi-reset-sequence = <1 50>, <0 10>, <1 130>;
	};
};

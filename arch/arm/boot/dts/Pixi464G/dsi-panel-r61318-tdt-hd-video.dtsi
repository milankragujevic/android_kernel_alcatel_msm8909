/* Copyright (c) 2015, The Linux Foundation. All rights reserved.
 *
 * This program is free software; you can redistribute it and/or modify
 * it under the terms of the GNU General Public License version 2 and
 * only version 2 as published by the Free Software Foundation.
 *
 * This program is distributed in the hope that it will be useful,
 * but WITHOUT ANY WARRANTY; without even the implied warranty of
 * MERCHANTABILITY or FITNESS FOR A PARTICULAR PURPOSE.  See the
 * GNU General Public License for more details.
 */

/*---------------------------------------------------------------------------
 * This file is autogenerated file using gcdb parser. Please do not edit it.
 * Update input XML file to add a new entry or update variable in this file
 * VERSION = "1.0"
 *---------------------------------------------------------------------------*/
&mdss_mdp {
	dsi_r61318_tdt_hd_video: qcom,mdss_dsi_r61318_tdt_hd_video {
		qcom,mdss-dsi-panel-name = "r61318 tdt hd video mode dsi panel";
		qcom,mdss-dsi-panel-controller = <&mdss_dsi0>;
		qcom,mdss-dsi-panel-type = "dsi_video_mode";
		qcom,mdss-dsi-panel-destination = "display_1";
		qcom,mdss-dsi-panel-framerate = <60>;
		qcom,mdss-dsi-virtual-channel-id = <0>;
		qcom,mdss-dsi-stream = <0>;
		qcom,mdss-dsi-panel-width = <720>;
		qcom,mdss-dsi-panel-height = <1280>;
		qcom,mdss-dsi-h-front-porch = <80>;
		qcom,mdss-dsi-h-back-porch = <80>;
		qcom,mdss-dsi-h-pulse-width = <10>;
		qcom,mdss-dsi-h-sync-skew = <0>;
		qcom,mdss-dsi-v-back-porch = <10>;
		qcom,mdss-dsi-v-front-porch = <17>;
		qcom,mdss-dsi-v-pulse-width = <2>;
		qcom,mdss-dsi-h-left-border = <0>;
		qcom,mdss-dsi-h-right-border = <0>;
		qcom,mdss-dsi-v-top-border = <0>;
		qcom,mdss-dsi-v-bottom-border = <0>;
		qcom,mdss-dsi-bpp = <24>;
		qcom,mdss-dsi-color-order = "rgb_swap_rgb";
		qcom,mdss-dsi-underflow-color = <0xff>;
		qcom,mdss-dsi-border-color = <0>;
		qcom,mdss-dsi-lp11-init = <1>;
		qcom,mdss-dsi-init-delay-us = <10000>;
		qcom,mdss-dsi-on-command = [
			29 01 00 00 00 00 02 B0 04
			29 01 00 00 00 00 02 E3 01
			29 01 00 00 00 00 02 E5 03
			29 01 00 00 00 00 02 B6 32
			29 01 00 00 00 00 07 C0 23 B2 0D 10 02 7F
			29 01 00 00 00 00 08 C1 23 8F A0 8F 0A 0A 55
			29 01 00 00 00 00 04 C4 B4 B0 00
			29 01 00 00 00 00 02 C3 20
			29 01 00 00 00 00 04 C5 06 02 00
			29 01 00 00 00 00 02 C6 C1
			29 01 00 00 00 00 1D C8 51 6B AD B5 D6 00 2A 7C AE 2D 76 90 8C B5 D6 1A 25 3A 6C 35 F7 60 05 A1 D6 5A 6B AD
			29 01 00 00 00 00 1F CA 13 0A 0F 15 1C 21 25 25 1E 1E 1B 15 11 0F 0E 03 0A 0F 15 1C 21 25 25 1E 1E 1B 15 11 0F 0E
			29 01 00 00 00 00 04 D0 05 10 4B
			29 01 00 00 00 00 02 D1 03
			29 01 00 00 00 00 03 D2 91 1F
			29 01 00 00 00 00 03 D3 11 33
			29 01 00 00 00 00 02 D4 35
			29 01 00 00 00 00 03 D5 34 34
			29 01 00 00 00 00 02 D6 01
			05 01 00 00 96 00 02 11 00
			05 01 00 00 32 00 02 29 00];
		qcom,mdss-dsi-off-command = [05 01 00 00 32 00 02 28 00
					05 01 00 00 96 00 02 10 00
					29 01 00 00 00 00 02 B0 04
					29 01 00 00 00 00 02 B1 01];
		qcom,mdss-dsi-on-command-state = "dsi_lp_mode";
		qcom,mdss-dsi-off-command-state = "dsi_hs_mode";
		qcom,mdss-dsi-h-sync-pulse = <1>;
		qcom,mdss-dsi-traffic-mode = "burst_mode";
		qcom,mdss-dsi-lane-map = "lane_map_0123";
		qcom,mdss-dsi-bllp-eof-power-mode;
		qcom,mdss-dsi-bllp-power-mode;
		qcom,mdss-dsi-lane-0-state;
		qcom,mdss-dsi-lane-1-state;
		qcom,mdss-dsi-lane-2-state;
		qcom,mdss-dsi-lane-3-state;
		qcom,mdss-dsi-panel-timings = [7B 1A 10 00 3E 40 16 1E 15 03 04 00];
		qcom,mdss-dsi-t-clk-post = <0x04>;
		qcom,mdss-dsi-t-clk-pre = <0x1A>;
		qcom,mdss-dsi-bl-min-level = <8>;
		qcom,mdss-dsi-bl-max-level = <255>;
		qcom,mdss-dsi-dma-trigger = "trigger_sw";
		qcom,mdss-dsi-mdp-trigger = "none";
		qcom,mdss-dsi-min-refresh-rate = <50>;
		qcom,mdss-dsi-bl-pmic-control-type = "bl_ctrl_pwm";
		qcom,mdss-dsi-reset-sequence = <1 10>, <0 10>, <1 20>;
		/*[PLATFORM]-Add-BEGIN by TCTSZ.yaohui.zeng,2015/12/24,add LCD ESD check function*/
		qcom,esd-check-enabled;
		qcom,mdss-dsi-panel-status-command = [06 01 00 01 05 00 01 0A];
		qcom,mdss-dsi-panel-status-command-state = "dsi_lp_mode";
		qcom,mdss-dsi-panel-status-check-mode = "reg_read";
		qcom,mdss-dsi-panel-status-value = <0x9C>;
		/*[PLATFORM]-Add-END by TCTSZ.yaohui.zeng,2015/12/24 */
	};
};

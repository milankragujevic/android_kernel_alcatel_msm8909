/* Copyright (c) 2014, The Linux Foundation. All rights reserved.
 *
 * This program is free software; you can redistribute it and/or modify
 * it under the terms of the GNU General Public License version 2 and
 * only version 2 as published by the Free Software Foundation.
 *
 * This program is distributed in the hope that it will be useful,
 * but WITHOUT ANY WARRANTY; without even the implied warranty of
 * MERCHANTABILITY or FITNESS FOR A PARTICULAR PURPOSE.  See the
 * GNU General Public License for more details.
 */

/*---------------------------------------------------------------------------
 * This file is autogenerated file using gcdb parser. Please do not edit it.
 * Update input XML file to add a new entry or update variable in this file
 * VERSION = "1.0"
 *---------------------------------------------------------------------------*/
&mdss_mdp {
	dsi_ili9881c_tdt_hd_vid: qcom,mdss_dsi_ili9881c_tdt_hd_video {
		qcom,mdss-dsi-panel-name = "ili9881c tdt hd video mode dsi panel[20150723]";
		qcom,mdss-dsi-panel-controller = <&mdss_dsi0>;
		qcom,mdss-dsi-panel-type = "dsi_video_mode";
		qcom,mdss-dsi-panel-destination = "display_1";
		qcom,mdss-dsi-panel-framerate = <62>;
		qcom,mdss-dsi-virtual-channel-id = <0>;
		qcom,mdss-dsi-stream = <0>;
		qcom,mdss-dsi-panel-width = <720>;
		qcom,mdss-dsi-panel-height = <1280>;
		qcom,mdss-dsi-h-front-porch = <90>;
		qcom,mdss-dsi-h-back-porch = <90>;
		qcom,mdss-dsi-h-pulse-width = <36>;
		qcom,mdss-dsi-h-sync-skew = <0>;
        qcom,mdss-dsi-v-front-porch = <15>;
		qcom,mdss-dsi-v-back-porch = <12>;
		qcom,mdss-dsi-v-pulse-width = <4>;
		qcom,mdss-dsi-h-left-border = <0>;
		qcom,mdss-dsi-h-right-border = <0>;
		qcom,mdss-dsi-v-top-border = <0>;
		qcom,mdss-dsi-v-bottom-border = <0>;
		qcom,mdss-dsi-bpp = <24>;
		qcom,mdss-dsi-underflow-color = <0xff>;
		qcom,mdss-dsi-border-color = <0>;
		qcom,mdss-dsi-on-command = [
			39 01 00 00 00 00 04 FF 98 81 03

//GIP_1

39 01 00 00 00 00 02 01 00
39 01 00 00 00 00 02 02 00
39 01 00 00 00 00 02 03 72
39 01 00 00 00 00 02 04 00
39 01 00 00 00 00 02 05 00
39 01 00 00 00 00 02 06 09
39 01 00 00 00 00 02 07 00
39 01 00 00 00 00 02 08 00
39 01 00 00 00 00 02 09 01
39 01 00 00 00 00 02 0A 00
39 01 00 00 00 00 02 0B 00
39 01 00 00 00 00 02 0C 01
39 01 00 00 00 00 02 0D 00
39 01 00 00 00 00 02 0E 00
39 01 00 00 00 00 02 0F 00
39 01 00 00 00 00 02 10 00 
39 01 00 00 00 00 02 11 00
39 01 00 00 00 00 02 12 00
39 01 00 00 00 00 02 13 00
39 01 00 00 00 00 02 14 00
39 01 00 00 00 00 02 15 00
39 01 00 00 00 00 02 16 00 
39 01 00 00 00 00 02 17 00
39 01 00 00 00 00 02 18 00
39 01 00 00 00 00 02 19 00
39 01 00 00 00 00 02 1A 00
39 01 00 00 00 00 02 1B 00
39 01 00 00 00 00 02 1C 00
39 01 00 00 00 00 02 1D 00
39 01 00 00 00 00 02 1E 40
39 01 00 00 00 00 02 1F 80
39 01 00 00 00 00 02 20 05
39 01 00 00 00 00 02 21 02
39 01 00 00 00 00 02 22 00
39 01 00 00 00 00 02 23 00
39 01 00 00 00 00 02 24 00
39 01 00 00 00 00 02 25 00
39 01 00 00 00 00 02 26 00
39 01 00 00 00 00 02 27 00
39 01 00 00 00 00 02 28 33
39 01 00 00 00 00 02 29 02
39 01 00 00 00 00 02 2A 00
39 01 00 00 00 00 02 2B 00
39 01 00 00 00 00 02 2C 00
39 01 00 00 00 00 02 2D 00
39 01 00 00 00 00 02 2E 00
39 01 00 00 00 00 02 2F 00
39 01 00 00 00 00 02 30 00
39 01 00 00 00 00 02 31 00
39 01 00 00 00 00 02 32 00
39 01 00 00 00 00 02 33 00
39 01 00 00 00 00 02 34 04
39 01 00 00 00 00 02 35 00
39 01 00 00 00 00 02 36 00
39 01 00 00 00 00 02 37 00
39 01 00 00 00 00 02 38 3C
39 01 00 00 00 00 02 39 00
39 01 00 00 00 00 02 3A 40 
39 01 00 00 00 00 02 3B 40
39 01 00 00 00 00 02 3C 00
39 01 00 00 00 00 02 3D 00
39 01 00 00 00 00 02 3E 00
39 01 00 00 00 00 02 3F 00
39 01 00 00 00 00 02 40 00
39 01 00 00 00 00 02 41 00
39 01 00 00 00 00 02 42 00
39 01 00 00 00 00 02 43 00
39 01 00 00 00 00 02 44 00
                  
                  
//GIP_2           
39 01 00 00 00 00 02 50 01
39 01 00 00 00 00 02 51 23
39 01 00 00 00 00 02 52 45
39 01 00 00 00 00 02 53 67
39 01 00 00 00 00 02 54 89
39 01 00 00 00 00 02 55 AB
39 01 00 00 00 00 02 56 01
39 01 00 00 00 00 02 57 23
39 01 00 00 00 00 02 58 45
39 01 00 00 00 00 02 59 67
39 01 00 00 00 00 02 5A 89
39 01 00 00 00 00 02 5B AB
39 01 00 00 00 00 02 5C AD
39 01 00 00 00 00 02 5D EF
                 
//GIP_3          
39 01 00 00 00 00 02 5E 01
39 01 00 00 00 00 02 5F 01
39 01 00 00 00 00 02 60 00
39 01 00 00 00 00 02 61 15
39 01 00 00 00 00 02 62 14
39 01 00 00 00 00 02 63 0E
39 01 00 00 00 00 02 64 0F
39 01 00 00 00 00 02 65 0C
39 01 00 00 00 00 02 66 0D
39 01 00 00 00 00 02 67 06
39 01 00 00 00 00 02 68 02
39 01 00 00 00 00 02 69 02
39 01 00 00 00 00 02 6A 02
39 01 00 00 00 00 02 6B 02
39 01 00 00 00 00 02 6C 02
39 01 00 00 00 00 02 6D 02
39 01 00 00 00 00 02 6E 07
39 01 00 00 00 00 02 6F 02
39 01 00 00 00 00 02 70 02
39 01 00 00 00 00 02 71 02
39 01 00 00 00 00 02 72 02
39 01 00 00 00 00 02 73 02
39 01 00 00 00 00 02 74 02
39 01 00 00 00 00 02 75 01
39 01 00 00 00 00 02 76 00
39 01 00 00 00 00 02 77 14
39 01 00 00 00 00 02 78 15
39 01 00 00 00 00 02 79 0E
39 01 00 00 00 00 02 7A 0F
39 01 00 00 00 00 02 7B 0C
39 01 00 00 00 00 02 7C 0D
39 01 00 00 00 00 02 7D 06
39 01 00 00 00 00 02 7E 02
39 01 00 00 00 00 02 7F 02
39 01 00 00 00 00 02 80 02
39 01 00 00 00 00 02 81 02
39 01 00 00 00 00 02 82 02
39 01 00 00 00 00 02 83 02
39 01 00 00 00 00 02 84 07
39 01 00 00 00 00 02 85 02
39 01 00 00 00 00 02 86 02
39 01 00 00 00 00 02 87 02
39 01 00 00 00 00 02 88 02
39 01 00 00 00 00 02 89 02
39 01 00 00 00 00 02 8A 02
                     
//CMD_Page 4         
39 01 00 00 00 00 04 FF 98 81 04
39 01 00 00 00 00 02 6C 15                //Set VCORE voltage =1.5V
39 01 00 00 00 00 02 6E 2A                //di_pwr_reg=0 for power mode 2A //VGH clamp 15V
39 01 00 00 00 00 02 6F 33                // reg vcl + pumping ratio VGH=3x VGL=-2.5x
39 01 00 00 00 00 02 3A 94                //POWER SAVING
39 01 00 00 00 00 02 8D 16               
39 01 00 00 00 00 02 87 BA                              
39 01 00 00 00 00 02 26 76            
39 01 00 00 00 00 02 B2 D1
39 01 00 00 00 00 02 B5 06
                  
//CMD_Page 1       
39 01 00 00 00 00 04 FF 98 81 01
39 01 00 00 00 00 02 22 0A		//BGR  SS
39 01 00 00 00 00 02 31 00		//column inversion
39 01 00 00 00 00 02 53 88		//VCOM1
39 01 00 00 00 00 02 55 8B		//VCOM2
39 01 00 00 00 00 02 50 AE		//VREG1OUT
39 01 00 00 00 00 02 51 AE		//VREG2OUT
39 01 00 00 00 00 02 60 28               //SDT
                  
39 01 00 00 00 00 02 A0 0F		//VP255	Gamma P
39 01 00 00 00 00 02 A1 1B               //VP251        
39 01 00 00 00 00 02 A2 28               //VP247        
39 01 00 00 00 00 02 A3 12               //VP243        
39 01 00 00 00 00 02 A4 15               //VP239        
39 01 00 00 00 00 02 A5 28               //VP231        
39 01 00 00 00 00 02 A6 1B               //VP219        
39 01 00 00 00 00 02 A7 1E               //VP203        
39 01 00 00 00 00 02 A8 79               //VP175        
39 01 00 00 00 00 02 A9 1B               //VP144        
39 01 00 00 00 00 02 AA 27               //VP111        
39 01 00 00 00 00 02 AB 69               //VP80         
39 01 00 00 00 00 02 AC 19               //VP52         
39 01 00 00 00 00 02 AD 18               //VP36         
39 01 00 00 00 00 02 AE 4C               //VP24         
39 01 00 00 00 00 02 AF 21               //VP16         
39 01 00 00 00 00 02 B0 28               //VP12         
39 01 00 00 00 00 02 B1 52               //VP8          
39 01 00 00 00 00 02 B2 65               //VP4          
39 01 00 00 00 00 02 B3 3F               //VP0          
                                        
39 01 00 00 00 00 02 C0 04		//VN255 GAMMA N
39 01 00 00 00 00 02 C1 1B               //VN251        
39 01 00 00 00 00 02 C2 27               //VN247        
39 01 00 00 00 00 02 C3 13               //VN243        
39 01 00 00 00 00 02 C4 15               //VN239        
39 01 00 00 00 00 02 C5 28               //VN231        
39 01 00 00 00 00 02 C6 1C               //VN219        
39 01 00 00 00 00 02 C7 1E               //VN203        
39 01 00 00 00 00 02 C8 79               //VN175        
39 01 00 00 00 00 02 C9 1A               //VN144        
39 01 00 00 00 00 02 CA 27               //VN111        
39 01 00 00 00 00 02 CB 69              //VN80         
39 01 00 00 00 00 02 CC 1A               //VN52         
39 01 00 00 00 00 02 CD 18               //VN36         
39 01 00 00 00 00 02 CE 4C               //VN24         
39 01 00 00 00 00 02 CF 21               //VN16         
39 01 00 00 00 00 02 D0 27               //VN12         
39 01 00 00 00 00 02 D1 52               //VN8          
39 01 00 00 00 00 02 D2 65               //VN4          
39 01 00 00 00 00 02 D3 3F               //VN0
     
//CMD_Page 0         
39 01 00 00 00 00 04 FF 98 81 00
05 01 00 00 00 00 02 35 00               //TE on;
05 01 00 00 78 00 02 11 00	//sleep out
//Delay\A3\AC120           
05 01 00 00 14 00 02 29 00	//display on
];	
		qcom,mdss-dsi-off-command = [ 	05 01 00 00 32 00 02 28 00
						05 01 00 00 78 00 02 10 00];
		qcom,mdss-dsi-on-command-state = "dsi_lp_mode";
		qcom,mdss-dsi-off-command-state = "dsi_lp_mode";
                /*LCD read register Check start
                qcom,esd-check-enabled;
		qcom,mdss-dsi-panel-status-command = [06 01 00 01 05 00 01 09];           //send command
                qcom,mdss-dsi-panel-status-command_for_one = [14 01 00 01 05 00 01 d9];   //send command one
		qcom,mdss-dsi-panel-status-command-state = "dsi_hs_mode";                 //user to lp mode read
		qcom,mdss-dsi-panel-status-check-mode = "reg_read_hx8394d";               //"reg_read_hx8394d";
		qcom,mdss-dsi-panel-status-value = <0x81 0x73 0x06>;                      //register return value1
                qcom,mdss-dsi-panel-status-value_for_one = <0x80>;                        //register return value2
                /*LCD read register Check End*/
                //add LCD TE check mode for pixi3-55 by SH richard.liang 2015-05-21
                qcom,esd-check-enabled;
                qcom,mdss-dsi-panel-status-check-mode = "te_signal_check"; 
                //end richard.liang
		qcom,mdss-dsi-h-sync-pulse = <1>;
		qcom,mdss-dsi-traffic-mode = "burst_mode";
		qcom,mdss-dsi-bllp-eof-power-mode;
		qcom,mdss-dsi-bllp-power-mode;
		qcom,mdss-dsi-lane-0-state;
		qcom,mdss-dsi-lane-1-state;
		qcom,mdss-dsi-lane-2-state;
		qcom,mdss-dsi-lane-3-state;
		//qcom,mdss-dsi-panel-timings = [82 1E 14 00 44 48 18 22 19 03 04 00];
		//qcom,mdss-dsi-panel-clockrate = <456000000>;
		qcom,mdss-dsi-panel-timings = [82 1C 12 00 40 42 18 20 17 03 04 00];
		qcom,mdss-dsi-t-clk-post = <0x04>;
		qcom,mdss-dsi-t-clk-pre = <0x1B>;
		qcom,mdss-dsi-bl-min-level = <1>;
		qcom,mdss-dsi-bl-max-level = <255>;
		qcom,mdss-dsi-post-init-delay = <4>;
                /*Before reset, beginning LP11*/
        qcom,mdss-dsi-lp11-init;
		qcom,mdss-dsi-init-delay-us = <50000>;
               
		qcom,mdss-dsi-dma-trigger = "trigger_sw";
		qcom,mdss-dsi-mdp-trigger = "none";
		qcom,mdss-dsi-bl-pmic-control-type = "bl_ctrl_gpio";
		qcom,mdss-dsi-reset-sequence = <1 10>, <0 10>, <1 120>;
		//add by yusen.ke.sz@tcl.com for fix Screen size error(display tester APK)
		qcom,mdss-pan-physical-width-dimension = <69>;
		qcom,mdss-pan-physical-height-dimension = <120>;
		//add end

	};
};

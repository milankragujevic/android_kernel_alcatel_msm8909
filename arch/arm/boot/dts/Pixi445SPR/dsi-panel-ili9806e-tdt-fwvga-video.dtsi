/* Copyright (c) 2014, The Linux Foundation. All rights reserved.
 *
 * This program is free software; you can redistribute it and/or modify
 * it under the terms of the GNU General Public License version 2 and
 * only version 2 as published by the Free Software Foundation.
 *
 * This program is distributed in the hope that it will be useful,
 * but WITHOUT ANY WARRANTY; without even the implied warranty of
 * MERCHANTABILITY or FITNESS FOR A PARTICULAR PURPOSE.  See the
 * GNU General Public License for more details.
 */

/*---------------------------------------------------------------------------
 * This file is autogenerated file using gcdb parser. Please do not edit it.
 * Update input XML file to add a new entry or update variable in this file
 * VERSION = "1.0"
 *---------------------------------------------------------------------------*/
&mdss_mdp {
	dsi_ili9806e_fwvga_tdt_vid: qcom,mdss_dsi_ili9806e_fwvga_tdt_video {
		qcom,mdss-dsi-panel-name = "ili9806e video mode tdt dsi panel[20151016] modify";
		qcom,mdss-dsi-panel-controller = <&mdss_dsi0>;
		qcom,mdss-dsi-panel-type = "dsi_video_mode";
		qcom,mdss-dsi-panel-destination = "display_1";
        qcom,mdss-dsi-panel-framerate = <60>;
		qcom,mdss-dsi-virtual-channel-id = <0>;
		qcom,mdss-dsi-stream = <0>;
		qcom,mdss-dsi-panel-width = <480>;
		qcom,mdss-dsi-panel-height = <854>;
		qcom,mdss-dsi-h-front-porch = <100>;
		qcom,mdss-dsi-h-back-porch = <80>;
		qcom,mdss-dsi-h-pulse-width = <4>;
		qcom,mdss-dsi-h-sync-skew = <0>;
		qcom,mdss-dsi-v-back-porch = <9>;
		qcom,mdss-dsi-v-front-porch = <20>;
		qcom,mdss-dsi-v-pulse-width = <2>;
		qcom,mdss-dsi-h-left-border = <0>;
		qcom,mdss-dsi-h-right-border = <0>;
		qcom,mdss-dsi-v-top-border = <0>;
		qcom,mdss-dsi-v-bottom-border = <0>;
		qcom,mdss-dsi-bpp = <24>;
		qcom,mdss-dsi-color-order = "rgb_swap_rgb";
		qcom,mdss-dsi-underflow-color = <0xff>;
		qcom,mdss-dsi-border-color = <0>;
		qcom,mdss-dsi-on-command = [
		
39 01 00 00 00 00 06 FF FF 98 06 04 01     // Change to Page 1		
39 01 00 00 00 00 02 08 10  // output SDA		
39 01 00 00 00 00 02 21 01  // DE = 1 Active		
39 01 00 00 00 00 02 30 01  // 480 X 854		
39 01 00 00 00 00 02 31 00  //column Inversion		
39 01 00 00 00 00 02 40 11  // BT  		
39 01 00 00 00 00 02 41 22  // DVDDH DVDDL clamp 		
39 01 00 00 00 00 02 42 03  // VGH/VGL 01		
39 01 00 00 00 00 02 43 89  // VGH_CLAMP 0N ;		
39 01 00 00 00 00 02 44 86 // VGL_CLAMP ON ; 		
39 01 00 00 00 00 02 50 70 //VGMP		
39 01 00 00 00 00 02 51 70 //VGMN		
39 01 00 00 00 00 02 52 00 //Flicker		
39 01 00 00 00 00 02 53 4A //Flicker		
39 01 00 00 00 00 02 60 0a // SDTI		
39 01 00 00 00 00 02 61 00 // CRTI		
39 01 00 00 00 00 02 62 0A // EQTI    08		
39 01 00 00 00 00 02 63 00  // PCTI	
39 01 00 00 00 00 02 A0 00  // Gamma 0 		
39 01 00 00 00 00 02 A1 0C  // Gamma 4 		
39 01 00 00 00 00 02 A2 15  // Gamma 8		
39 01 00 00 00 00 02 A3 0F  // Gamma 16		
39 01 00 00 00 00 02 A4 09  // Gamma 24		
39 01 00 00 00 00 02 A5 15  // Gamma 52		
39 01 00 00 00 00 02 A6 0A  // Gamma 80		
39 01 00 00 00 00 02 A7 0B // Gamma 108		
39 01 00 00 00 00 02 A8 02  // Gamma 147		
39 01 00 00 00 00 02 A9 06  // Gamma 175		
39 01 00 00 00 00 02 AA 06  // Gamma 203		
39 01 00 00 00 00 02 AB 07  // Gamma 231		
39 01 00 00 00 00 02 AC 0C // Gamma 239		
39 01 00 00 00 00 02 AD 34  // Gamma 247		
39 01 00 00 00 00 02 AE 30  // Gamma 251		
39 01 00 00 00 00 02 AF 00  // Gamma 255		
39 01 00 00 00 00 02 C0 00  // Gamma 0 		
39 01 00 00 00 00 02 C1 07  // Gamma 4 		
39 01 00 00 00 00 02 C2 0F  // Gamma 8		
39 01 00 00 00 00 02 C3 0F  // Gamma 16		
39 01 00 00 00 00 02 C4 08  // Gamma 24		
39 01 00 00 00 00 02 C5 13  // Gamma 52		
39 01 00 00 00 00 02 C6 09  // Gamma 80		
39 01 00 00 00 00 02 C7 06  // Gamma 108		
39 01 00 00 00 00 02 C8 05  // Gamma 147		
39 01 00 00 00 00 02 C9 0A  // Gamma 175		
39 01 00 00 00 00 02 CA 08  // Gamma 203		
39 01 00 00 00 00 02 CB 03  // Gamma 231		
39 01 00 00 00 00 02 CC 0B  // Gamma 239		
39 01 00 00 00 00 02 CD 28  // Gamma 247		
39 01 00 00 00 00 02 CE 22  // Gamma 251		
39 01 00 00 00 00 02 CF 00  // Gamma 255		
39 01 00 00 00 00 06 FF FF 98 06 04 06     // Change to Page 6		
39 01 00 00 00 00 02 00 21		
39 01 00 00 00 00 02 01 0A		
39 01 00 00 00 00 02 02 00    		
39 01 00 00 00 00 02 03 00		
39 01 00 00 00 00 02 04 01		
39 01 00 00 00 00 02 05 01		
39 01 00 00 00 00 02 06 80    		
39 01 00 00 00 00 02 07 06		
39 01 00 00 00 00 02 08 01		
39 01 00 00 00 00 02 09 80    		
39 01 00 00 00 00 02 0A 00    		
39 01 00 00 00 00 02 0B 00    		
39 01 00 00 00 00 02 0C 0A   		
39 01 00 00 00 00 02 0D 0A		
39 01 00 00 00 00 02 0E 00   //00		
39 01 00 00 00 00 02 0F 00   // 00		
39 01 00 00 00 00 02 10 F0		
39 01 00 00 00 00 02 11 F4		
39 01 00 00 00 00 02 12 04		
39 01 00 00 00 00 02 13 00		
39 01 00 00 00 00 02 14 00		
39 01 00 00 00 00 02 15 C0		
39 01 00 00 00 00 02 16 08		
39 01 00 00 00 00 02 17 00		
39 01 00 00 00 00 02 18 00		
39 01 00 00 00 00 02 19 00		
39 01 00 00 00 00 02 1A 00 		
39 01 00 00 00 00 02 1B 00 		
39 01 00 00 00 00 02 1C 00 		
39 01 00 00 00 00 02 1D 00		
39 01 00 00 00 00 02 20 01 		
39 01 00 00 00 00 02 21 23 		
39 01 00 00 00 00 02 22 45 		
39 01 00 00 00 00 02 23 67 		
39 01 00 00 00 00 02 24 01 		
39 01 00 00 00 00 02 25 23 		
39 01 00 00 00 00 02 26 45 		
39 01 00 00 00 00 02 27 67		
39 01 00 00 00 00 02 30 01 		
39 01 00 00 00 00 02 31 11	//GOUT1 	
39 01 00 00 00 00 02 32 00	//GOUT2 	
39 01 00 00 00 00 02 33 EE	//GOUT3 	
39 01 00 00 00 00 02 34 FF	//GOUT4 	
39 01 00 00 00 00 02 35 BB	//GOUT5 	
39 01 00 00 00 00 02 36 CA	//GOUT6 	
39 01 00 00 00 00 02 37 DD	//GOUT7 	
39 01 00 00 00 00 02 38 AC	//GOUT8 	
39 01 00 00 00 00 02 39 76	//GOUT9 	
39 01 00 00 00 00 02 3A 67//GOUT10 	
39 01 00 00 00 00 02 3B 22//GOUT11 	
39 01 00 00 00 00 02 3C 22//GOUT12 	
39 01 00 00 00 00 02 3D 22//GOUT13 	
39 01 00 00 00 00 02 3E 22//GOUT14 	
39 01 00 00 00 00 02 3F 22 		
39 01 00 00 00 00 02 40 22		
39 01 00 00 00 00 02 52 10 		
39 01 00 00 00 00 02 53 10 // VGLO tie VGL_REG		
39 01 00 00 00 00 02 58 97		
39 01 00 00 00 00 06 FF FF 98 06 04 07// Change to Page 7 		
39 01 00 00 00 00 02 17 22  //  		
39 01 00 00 00 00 02 02 77  //  		
39 01 00 00 00 00 02 E1 79  // 		
39 01 00 00 00 00 06 FF FF 98 06 04 00     // Change to Page 0		
05 01 00 00 00 00 02 35 00// TE on		
05 01 00 00 96 00 02 11 00// Sleep-Out	
05 01 00 00 32 00 02 29 00// Display on	
 ];
		qcom,mdss-dsi-off-command = [05 01 00 00 32 00 02 28 00
					05 01 00 00 79 00 02 10 00];
		qcom,mdss-dsi-on-command-state = "dsi_lp_mode";
		qcom,mdss-dsi-off-command-state = "dsi_lp_mode";
		qcom,mdss-dsi-h-sync-pulse = <1>;
		qcom,mdss-dsi-traffic-mode = <2>;
		qcom,mdss-dsi-lane-map =<0>; 
		qcom,mdss-dsi-bllp-eof-power-mode;
		qcom,mdss-dsi-bllp-power-mode;
		qcom,mdss-dsi-lane-0-state;
		qcom,mdss-dsi-lane-1-state;
		qcom,mdss-dsi-panel-timings = [D5 1D 12 01 3E 42 16 21 14 03 04 00];//modify by yusen.ke.sz@tcl.com at 20151204 for Optimized MiPI timing
		qcom,mdss-dsi-t-clk-post = <0x05>;
		qcom,mdss-dsi-t-clk-pre = <0x36>;
		//qcom,mdss-dsi-panel-clockrate = <400000000>; //cwying 2015.1.7 disable 
		qcom,mdss-dsi-bl-min-level = <1>;
		qcom,mdss-dsi-bl-max-level = <255>;
		qcom,mdss-dsi-dma-trigger = <4>; 
		qcom,mdss-dsi-mdp-trigger = <0>; 
		qcom,mdss-dsi-bl-pmic-control-type = "bl_ctrl_gpio";
		qcom,mdss-dsi-reset-sequence = <1 20>, <0 20>, <1 120>;
		qcom,mdss-pan-physical-width-dimension = <56>;
		qcom,mdss-pan-physical-height-dimension = <99>;
		qcom,esd-check-enabled;
		qcom,mdss-dsi-panel-status-command = [
		06 01 00 01 05 00 02 0a 00
		];
		qcom,mdss-dsi-panel-status-command-state = "dsi_lp_mode";
		qcom,mdss-dsi-panel-status-check-mode = "reg_read";
		qcom,mdss-dsi-panel-status-value = <0x9C>;
	};
};

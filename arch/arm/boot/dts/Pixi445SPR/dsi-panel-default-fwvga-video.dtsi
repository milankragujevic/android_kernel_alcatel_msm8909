/* Copyright (c) 2014, The Linux Foundation. All rights reserved.
 *
 * This program is free software; you can redistribute it and/or modify
 * it under the terms of the GNU General Public License version 2 and
 * only version 2 as published by the Free Software Foundation.
 *
 * This program is distributed in the hope that it will be useful,
 * but WITHOUT ANY WARRANTY; without even the implied warranty of
 * MERCHANTABILITY or FITNESS FOR A PARTICULAR PURPOSE.  See the
 * GNU General Public License for more details.
 */

/*---------------------------------------------------------------------------
 * This file is autogenerated file using gcdb parser. Please do not edit it.
 * Update input XML file to add a new entry or update variable in this file
 * VERSION = "1.0"
 *---------------------------------------------------------------------------*/
&mdss_mdp {
	dsi_default_fwvga_vid: qcom,mdss_dsi_default_fwvga_video {
		qcom,mdss-dsi-panel-name = "default video mode dsi panel[20150303] modify";
		qcom,mdss-dsi-panel-controller = <&mdss_dsi0>;
		qcom,mdss-dsi-panel-type = "dsi_video_mode";
		qcom,mdss-dsi-panel-destination = "display_1";
       		qcom,mdss-dsi-panel-framerate = <60>;
		qcom,mdss-dsi-virtual-channel-id = <0>;
		qcom,mdss-dsi-stream = <0>;
		qcom,mdss-dsi-panel-width = <480>;
		qcom,mdss-dsi-panel-height = <854>;
		qcom,mdss-dsi-h-front-porch = <100>;
		qcom,mdss-dsi-h-back-porch = <80>;
		qcom,mdss-dsi-h-pulse-width = <4>;
		qcom,mdss-dsi-h-sync-skew = <0>;
		qcom,mdss-dsi-v-back-porch = <8>;
		qcom,mdss-dsi-v-front-porch = <22>;
		qcom,mdss-dsi-v-pulse-width = <2>;
		qcom,mdss-dsi-h-left-border = <0>;
		qcom,mdss-dsi-h-right-border = <0>;
		qcom,mdss-dsi-v-top-border = <0>;
		qcom,mdss-dsi-v-bottom-border = <0>;
		qcom,mdss-dsi-bpp = <24>;
		qcom,mdss-dsi-color-order = "rgb_swap_rgb";
		qcom,mdss-dsi-underflow-color = <0xff>;
		qcom,mdss-dsi-border-color = <0>;
		qcom,mdss-dsi-on-command = [
		
        	39 01 00 00 00 00 04 B9 FF 83 79
		39 01 00 00 00 00 03 BA 51 93 
		39 01 00 00 00 00 15 B1 44 18 18 31 91 90 D0 EE DE 
					80 38 38 F8 44 44 42 00 80 30 00

		39 01 00 00 00 00 0A B2 80 FE 0A 03 20 50 11 42 1D  
		39 01 00 00 00 00 0E B4 01 52 00 52 00 52 07 52 07 52 B0 00 FF
		39 01 00 00 00 00 02 CC 02
		39 01 00 00 00 00 02 D2 77

		39 01 00 00 00 00 1E D3 00 07 00 00 00 06 06 32 10 
					03 00 03 03 5F 03 5F 00 08 00
				 	08 35 33 07 07 37 07 07 37 08 
										     
		39 01 00 00 00 00 21 D5 18 18 19 19 18 18 20 21 24 
					25 18 18 18 18 00 01 04 05 02
					03 06 07 18 18 18 18 18 18 18 18 18 18
										
		39 01 00 00 00 00 21 D6 18 18 18 18 19 19 25 24 21 
					20 18 18 18 18 05 04 01 00 03 
					02 07 06 18 18 18 18 18 18 18 18 18 18


		39 01 00 00 00 00 2B E0 00 07 09 14 14 3F 2c 39
			 		07 0F 12 1a 11 15 18 16 16 08
			 		13 12 1a
00 07 09 14 14 3F 2c 39
			 		07 0F 12 1a 11 15 18 16 16 08
			 		13 12 1a

		39 01 00 00 00 00 03 B6 38 38
		15 01 00 00 00 00 02 35 00

  
		05 01 00 00 96 00 02 11 00
		05 01 00 00 32 00 02 29 00
];
		qcom,mdss-dsi-off-command = [05 01 00 00 02 00 02 28 00
					05 01 00 00 79 00 02 10 00];
		qcom,mdss-dsi-on-command-state = "dsi_lp_mode";
		qcom,mdss-dsi-off-command-state = "dsi_hs_mode";
		qcom,mdss-dsi-h-sync-pulse = <1>;
		qcom,mdss-dsi-traffic-mode = <2>;//"burst_mode";
		qcom,mdss-dsi-lane-map =<0>; //"lane_map_0123";//modify by yusen.ke.sz@tcl.com at 20140714 for lcd driver
		qcom,mdss-dsi-bllp-eof-power-mode;
		qcom,mdss-dsi-bllp-power-mode;
		qcom,mdss-dsi-lane-0-state;
		qcom,mdss-dsi-lane-1-state;

		qcom,mdss-dsi-panel-timings = [D5 18 10 00 38 3E 12 1A 13 03 04 00];
		qcom,mdss-dsi-t-clk-post = <0x05>;
		qcom,mdss-dsi-t-clk-pre = <0x36>;
		qcom,mdss-dsi-bl-min-level = <1>;
		qcom,mdss-dsi-bl-max-level = <255>;
		qcom,mdss-dsi-dma-trigger = <4>;//"trigger_sw";
		qcom,mdss-dsi-mdp-trigger = <0>;//"none";
		qcom,mdss-dsi-bl-pmic-control-type = "bl_ctrl_gpio";
		qcom,mdss-dsi-reset-sequence = <1 20>, <0 10>, <1 120>;
		qcom,mdss-pan-physical-width-dimension = <0>;
		qcom,mdss-pan-physical-height-dimension = <0>;
		//qcom,esd-check-enabled;
		qcom,mdss-dsi-panel-status-command = [
		14 01 00 01 05 00 02 0a 00
		];
		qcom,mdss-dsi-panel-status-command-state = "dsi_lp_mode";
		qcom,mdss-dsi-panel-status-check-mode = "reg_read";
		qcom,mdss-dsi-panel-status-value = <0x1C>;
	};
};

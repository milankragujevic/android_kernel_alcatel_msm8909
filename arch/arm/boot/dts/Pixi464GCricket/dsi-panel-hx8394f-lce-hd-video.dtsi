/* Copyright (c) 2015, The Linux Foundation. All rights reserved.
 *
 * This program is free software; you can redistribute it and/or modify
 * it under the terms of the GNU General Public License version 2 and
 * only version 2 as published by the Free Software Foundation.
 *
 * This program is distributed in the hope that it will be useful,
 * but WITHOUT ANY WARRANTY; without even the implied warranty of
 * MERCHANTABILITY or FITNESS FOR A PARTICULAR PURPOSE.  See the
 * GNU General Public License for more details.
 */

/*---------------------------------------------------------------------------
 * This file is autogenerated file using gcdb parser. Please do not edit it.
 * Update input XML file to add a new entry or update variable in this file
 * VERSION = "1.0"
 *---------------------------------------------------------------------------*/
&mdss_mdp {
	dsi_hx8394f_lce_hd_video: qcom,mdss_dsi_hx8394f_lce_hd_video {
		qcom,mdss-dsi-panel-name = "hx8394f lce hd video mode dsi panel";
		qcom,mdss-dsi-panel-controller = <&mdss_dsi0>;
		qcom,mdss-dsi-panel-type = "dsi_video_mode";
		qcom,mdss-dsi-panel-destination = "display_1";
		qcom,mdss-dsi-panel-framerate = <60>;
		qcom,mdss-dsi-virtual-channel-id = <0>;
		qcom,mdss-dsi-stream = <0>;
		qcom,mdss-dsi-panel-width = <720>;
		qcom,mdss-dsi-panel-height = <1280>;
		qcom,mdss-dsi-h-front-porch = <16>;
		qcom,mdss-dsi-h-back-porch = <16>;
		qcom,mdss-dsi-h-pulse-width = <4>;
		qcom,mdss-dsi-h-sync-skew = <0>;
		qcom,mdss-dsi-v-back-porch = <12>;
		qcom,mdss-dsi-v-front-porch = <12>;
		qcom,mdss-dsi-v-pulse-width = <1>;
		qcom,mdss-dsi-h-left-border = <0>;
		qcom,mdss-dsi-h-right-border = <0>;
		qcom,mdss-dsi-v-top-border = <0>;
		qcom,mdss-dsi-v-bottom-border = <0>;
		qcom,mdss-dsi-bpp = <24>;
		qcom,mdss-dsi-color-order = "rgb_swap_rgb";
		qcom,mdss-dsi-underflow-color = <0xff>;
		qcom,mdss-dsi-border-color = <0>;
		qcom,mdss-dsi-lp11-init = <1>;
		qcom,mdss-dsi-init-delay-us = <10000>;
		qcom,mdss-dsi-on-command = [
			39 01 00 00 00 00 04 B9 FF 83 94
			39 01 00 00 00 00 0F B1 50 15 75 09 32 44 71 31 55 2F 56 73 02 02
			39 01 00 00 00 00 07 BA 63 03 68 6B B2 C0
			15 01 00 00 0A 00 02 D2 88
			39 01 00 00 00 00 06 B2 00 80 64 10 07
			39 01 00 00 00 00 16 B4 01 7C 01 7C 01 7C 01 05 8E 35 00 3F 01 7C 01 7C 01 7C 01 05 8E
			39 01 00 00 00 00 22 D3 00 00 07 07 40 1E 08 00 32 10 08 00 08 54 15 10 05 04 02 12 10 05 07 23 23 0C 0C 27 10 07 07 10 40
			39 01 00 00 00 00 2D D5 04 05 06 07 00 01 02 03 20 21 22 23 18 18 18 18 18 18 18 18 19 19 18 18 18 18 1B 1B 1A 1A 18 18 18 18 18 18 18 18 18 18 18 18 18 18
			39 01 00 00 00 00 2D D6 03 02 01 00 07 06 05 04 23 22 21 20 18 18 18 18 18 18 58 58 18 18 19 19 18 18 1B 1B 1A 1A 18 18 18 18 18 18 18 18 18 18 18 18 18 18
			39 01 00 00 00 00 3B E0 00 02 07 0F 10 13 18 15 35 41 55 55 63 75 7B 83 92 A0 99 AB BA 5A 59 5D 61 63 6C 72 7F 00 02 07 0F 10 13 18 15 35 41 55 55 63 75 7B 83 92 A0 99 AB BA 5A 59 5D 61 63 6C 72 7F
			15 01 00 00 0A 00 02 BD 00
			39 01 00 00 00 00 2C C1 01 00 05 0C 13 1A 21 27 2F 36 3C 42 47 4C 54 5B 63 6A 72 7A 82 8A 92 9B A5 AF B8 C0 CA D3 DD E8 F2 FF 21 9B E1 DD E4 7C 04 84 C0
			15 01 00 00 0A 00 02 BD 01
			39 01 00 00 00 00 2B C1 00 05 0C 13 1A 21 27 2F 36 3C 42 47 4C 54 5B 63 6A 72 7A 82 8A 92 9B A5 AF B8 C0 CA D3 DD E8 F2 FF 21 9B E1 DD E4 7C 04 84 C0
			15 01 00 00 0A 00 02 BD 02
			39 01 00 00 00 00 2B C1 00 05 0C 13 1A 21 27 2F 36 3C 42 47 4C 54 5B 63 6A 72 7A 82 8A 92 9B A5 AF B8 C0 CA D3 DD E8 F2 FF 21 9B E1 DD E4 7C 04 84 C0
			15 01 00 00 0A 00 02 CC 0B
			39 01 00 00 00 00 03 C0 1F 73
			39 01 00 00 00 00 03 B6 46 46
			15 01 00 00 0A 00 02 D4 02
			15 01 00 00 0A 00 02 BD 01		
			15 01 00 00 0A 00 02 B1 60
			15 01 00 00 0A 00 02 BD 00
			15 01 00 00 0A 00 02 35 00 
			05 01 00 00 C8 00 02 11 00
			05 01 00 00 0A 00 02 29 00];
		qcom,mdss-dsi-off-command = [05 01 00 00 32 00 02 28 00
					05 01 00 00 96 00 02 10 00];
		qcom,mdss-dsi-on-command-state = "dsi_lp_mode";
		qcom,mdss-dsi-off-command-state = "dsi_hs_mode";
		qcom,mdss-dsi-h-sync-pulse = <1>;
		qcom,mdss-dsi-traffic-mode = "non_burst_sync_event";
		qcom,mdss-dsi-lane-map = "lane_map_0123";
		qcom,mdss-dsi-bllp-eof-power-mode;
		qcom,mdss-dsi-bllp-power-mode;
		qcom,mdss-dsi-lane-0-state;
		qcom,mdss-dsi-lane-1-state;
		qcom,mdss-dsi-lane-2-state;
		qcom,mdss-dsi-lane-3-state;
		qcom,mdss-dsi-panel-timings = [8A 16 0E 00 38 3C 12 1A 10 03 04 00];
		qcom,mdss-dsi-t-clk-post = <0x04>;
		qcom,mdss-dsi-t-clk-pre = <0x1B>;
		qcom,mdss-dsi-bl-min-level = <8>;
		qcom,mdss-dsi-bl-max-level = <255>;
		qcom,mdss-dsi-dma-trigger = "trigger_sw";
		qcom,mdss-dsi-mdp-trigger = "none";
		qcom,mdss-dsi-min-refresh-rate = <50>;
		qcom,mdss-dsi-bl-pmic-control-type = "bl_ctrl_pwm";
		qcom,mdss-dsi-reset-sequence = <1 10>, <0 10>, <1 100>;
		/*[PLATFORM]-Add-BEGIN by TCTSZ.yaohui.zeng,2015/12/24,add LCD ESD check function*/
		/*qcom,esd-check-enabled;
		/*[PLATFORM]-Mod-BEGIN by TCTSZ.yaohui.zeng,2016/01/12,use TE ESD*/
		/*qcom,mdss-dsi-panel-status-check-mode = "te_signal_check";
		/*
		qcom,mdss-dsi-panel-status-command = [06 01 00 01 05 00 01 0A];
		qcom,mdss-dsi-panel-status-command-state = "dsi_lp_mode";
		qcom,mdss-dsi-panel-status-check-mode = "reg_read";
		qcom,mdss-dsi-panel-status-value = <0x9C>;*/
		/*[PLATFORM]-Add-END by TCTSZ.yaohui.zeng,2015/12/24 */
		/*[PLATFORM]-Mod-END by TCTSZ.yaohui.zeng,2016/01/12*/
	};
};

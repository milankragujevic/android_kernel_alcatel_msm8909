/* Copyright (c) 2014, The Linux Foundation. All rights reserved.
 *
 * This program is free software; you can redistribute it and/or modify
 * it under the terms of the GNU General Public License version 2 and
 * only version 2 as published by the Free Software Foundation.
 *
 * This program is distributed in the hope that it will be useful,
 * but WITHOUT ANY WARRANTY; without even the implied warranty of
 * MERCHANTABILITY or FITNESS FOR A PARTICULAR PURPOSE.  See the
 * GNU General Public License for more details.
 */

/*---------------------------------------------------------------------------
 * This file is autogenerated file using gcdb parser. Please do not edit it.
 * Update input XML file to add a new entry or update variable in this file
 * VERSION = "1.0"
 *---------------------------------------------------------------------------*/
&mdss_mdp {
	dsi_hx8394d_txd_hd_vid: qcom,mdss_dsi_hx8394d_txd_hd_video {
		qcom,mdss-dsi-panel-name = "hx8394d txd hd video mode dsi panel[20150623]";
		qcom,mdss-dsi-panel-controller = <&mdss_dsi0>;
		qcom,mdss-dsi-panel-type = "dsi_video_mode";
		qcom,mdss-dsi-panel-destination = "display_1";
		qcom,mdss-dsi-panel-framerate = <60>;
		qcom,mdss-dsi-virtual-channel-id = <0>;
		qcom,mdss-dsi-stream = <0>;
		qcom,mdss-dsi-panel-width = <720>;
		qcom,mdss-dsi-panel-height = <1280>;
		qcom,mdss-dsi-h-front-porch = <90>;
		qcom,mdss-dsi-h-back-porch = <90>;
		qcom,mdss-dsi-h-pulse-width = <36>;
		qcom,mdss-dsi-h-sync-skew = <0>;
                qcom,mdss-dsi-v-front-porch = <15>;
		qcom,mdss-dsi-v-back-porch = <12>;
		qcom,mdss-dsi-v-pulse-width = <4>;
		qcom,mdss-dsi-h-left-border = <0>;
		qcom,mdss-dsi-h-right-border = <0>;
		qcom,mdss-dsi-v-top-border = <0>;
		qcom,mdss-dsi-v-bottom-border = <0>;
		qcom,mdss-dsi-bpp = <24>;
		qcom,mdss-dsi-underflow-color = <0xff>;
		qcom,mdss-dsi-border-color = <0>;
		qcom,mdss-dsi-on-command = [
			39 01 00 00 00 00 04 
			B9 FF 83 94
                        39 01 00 00 00 00 03
			BA 33 83
			39 01 00 00 00 00 10 
			B1 6C 0F 0F
			34 04 11 F1
			81 2E 9F 23
			80 C0 D2 58
			39 01 00 00 00 00 0C
			B2 00 64 0E
 			0D 32 1C 08
			08 1C 4D 00
			39 01 00 00 00 00 0D
			B4 00 FF 51
			5A 59 5A 03 
			5A 01 6A 01
			6A
   		        39 01 00 00 00 00 26
			D3 00 07 00
			40 07 10 00 
			08 10 08 00
			08 54 15 0E
			05 0E 02 15
			06 05 06 47
			44 0A 0A 4B
			10 07 07 08
			00 00 00 0A
			00 01		
                        39 01 00 00 00 00 2D 
			D5 1A 1A 1B
			1B 00 01 02
			03 04 05 06
			07 08 09 0A
			0B 24 25 18
			18 26 27 18
			18 18 18 18
			18 18 18 18
			18 18 18 18
			18 18 18 20
			21 18 18 18
			18 
			39 01 00 00 00 00 2D
			D6 1A 1A 1B
			1B 0B 0A 09
			08 07 06 05
			04 03 02 01
			00 21 20 58
			58 27 26 18
			18 18 18 18
			18 18 18 18
			18 18 18 18
			18 18 18 25
			24 18 18 18
			18
			39 01 00 00 00 00 2B
			E0 00 05 0A
			1E 1A 3F 16
			34 06 0A 0C
			17 0E 11 14
			12 13 0A 13
			14 16 00 05
			0A 1E 1A 3F
			16 34 06 0A
			0C 17 0E 11
			14 12 13 0A
			13 14 16			
                        39 01 00 00 00 00 02 CC 09
                        39 01 00 00 00 00 05
			C7 00 C0 00 C0
                        39 01 00 00 00 00 03 B6 46 46
                        39 01 00 00 00 00 02 35 00          //add by SH richard.liang
			05 01 00 00 78 00 02 11 00
			05 01 00 00 14 00 02 29 00];
		qcom,mdss-dsi-off-command = [ 05 01 00 00 78 00 02 10 00];
		qcom,mdss-dsi-on-command-state = "dsi_lp_mode";
		qcom,mdss-dsi-off-command-state = "dsi_hs_mode";
                /*LCD read register Check start
                qcom,esd-check-enabled;
		qcom,mdss-dsi-panel-status-command = [06 01 00 01 05 00 01 09];           //send command
                qcom,mdss-dsi-panel-status-command_for_one = [14 01 00 01 05 00 01 d9];   //send command one
		qcom,mdss-dsi-panel-status-command-state = "dsi_hs_mode";                 //user to lp mode read
		qcom,mdss-dsi-panel-status-check-mode = "reg_read_hx8394d";               //"reg_read_hx8394d";
		qcom,mdss-dsi-panel-status-value = <0x81 0x73 0x06>;                      //register return value1
                qcom,mdss-dsi-panel-status-value_for_one = <0x80>;                        //register return value2
                /*LCD read register Check End*/
                //add LCD TE check mode for pixi3-55 by SH richard.liang 2015-05-21
                qcom,esd-check-enabled;
                qcom,mdss-dsi-panel-status-check-mode = "te_signal_check"; 
                //end richard.liang
		qcom,mdss-dsi-h-sync-pulse = <1>;
		qcom,mdss-dsi-traffic-mode = "burst_mode";
		qcom,mdss-dsi-bllp-eof-power-mode;
		qcom,mdss-dsi-bllp-power-mode;
		qcom,mdss-dsi-lane-0-state;
		qcom,mdss-dsi-lane-1-state;
		qcom,mdss-dsi-lane-2-state;
		qcom,mdss-dsi-lane-3-state;
		qcom,mdss-dsi-panel-timings = [82 1C 12 00 40 42 16 1E 14 03 04 00];
		qcom,mdss-dsi-t-clk-post = <0x04>;
		qcom,mdss-dsi-t-clk-pre = <0x1B>;
		qcom,mdss-dsi-bl-min-level = <1>;
		qcom,mdss-dsi-bl-max-level = <255>;
                /*Before reset, beginning LP11*/
                qcom,mdss-dsi-lp11-init;
		qcom,mdss-dsi-init-delay-us = <50000>;
                /*Before reset, beginning LP11*/
                qcom,mdss-dsi-bl-pmic-pwm-frequency = <33>;
                qcom,mdss-dsi-bl-pmic-bank-select = <0>;
		qcom,mdss-dsi-dma-trigger = "trigger_sw";
		qcom,mdss-dsi-mdp-trigger = "none";
		qcom,mdss-dsi-bl-pmic-control-type = "bl_ctrl_pwm";
		qcom,mdss-dsi-reset-sequence = <1 10>, <0 10>, <1 120>;
		//qcom,mdss-pan-physical-width-dimension = <59>;
		//qcom,mdss-pan-physical-height-dimension = <104>;

	};
};

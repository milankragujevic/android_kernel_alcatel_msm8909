## drivers/TCT_debug/Kconfig
```kconfig
menuconfig TCT_DEBUG
	bool "TCT debug support"
	default y
	---help---
	  This option add tct debug support.

if TCT_DEBUG

config TCT_DEBUG_BOOTPROF
	bool "bootprof"
	default y
	---help---
	  add bootprof support.

config TCT_LOG_PRINTK
	bool "add pid/cpu to printk"
	default y
	---help---
		add pid/cpu to printk.


config TCT_LOG_PANIC
	bool "add cpu status and stack dump to panic"
	default y
	---help---
		add tct log to panic.

config TCT_DEBUG_SAVE_BOOT_MSG
	default y
	bool "TCT debug: saving kernel log of booting to memory"
	---help---
	  file node:/proc/bootmsg

config TCT_LOG_RAMOOPS
	default y
	select PSTORE
	select PSTORE_CONSOLE
	select PSTORE_RAM
	bool "ramoops support"
	---help---
	  log kmsg/ftrace/panic/oops into pstore's ram buffer.

config TCT_WDOG_DUMP
	default y
	bool "dump cpu regs while watchdog timeout"
	---help---
	  save last cpu regs into '/proc/last_cpu' while watchdog timeout.

config TCT_DEBUG_BOOT_REASON
	default y
	bool "show boot reason"
	---help---
		show boot reason at '/proc/boot_reason'.
# [Feature]-Add-BEGIN by TCTSZ. add android - kernel timestamp wenzhao.guo@tcl.com, 2015/07/17, for [Task-433879]
config TCT_DEBUG_BOOT_TIME
	default y
	bool "show boot time"
	---help---
		show boot time at '/proc/boot_time'.
# [Feature]-Add-BEGIN by TCTSZ. add android - kernel timestamp wenzhao.guo@tcl.com, 2015/07/17, for [Task-433879]

# [Feature]-Add-BEGIN by TCTSZ. add klog. xiaoju.liang@tcl.com, 2015/07/20, for [Task-403392]
config TCT_DEBUG_KLOG
	default y
	tristate "print kernel log to userspace by netlink."
	---help---
	  print kernel log to userspace by netlink.
# [Feature]-Add-END by TCTSZ. xiaoju.liang@tcl.com, 2015/07/20, for [Task-403392]

# [Feature]-Add-BEGIN by TCTSZ. add watchdog timeout test method wenzhao.guo@tcl.com, 2015/07/28, for [Task-403392]
config TCT_DEBUG_WATCHDOG_TEST
	default n
	bool "TCT debug: provide a interface to test watchdog timeout"
	---help---
	  echo 0 > /sys/kernel/debug/fire_watchdog_reset or fire_softlockup_reset to trigger the watchdog timeout
# [Feature]-Add-END by TCTSZ. add watchdog timeout test method wenzhao.guo@tcl.com, 2015/07/28, for [Task-403392]

# [Feature]-Add-BEGIN by TCTSZ. add mmc dumper. xiaoju.liang@tcl.com, 2015/08/06, for [Task-403392]
config TCT_DEBUG_MMC
	default y
	bool "mmc dumper"
	---help---
	  ...
# [Feature]-Add-END by TCTSZ. xiaoju.liang@tcl.com, 2015/08/06, for [Task-403392]
# [Feature]-Add-BEGIN by TCTSZ. add uart log output controller. wenzhao.guo@tcl.com, 2015/09/23, for [Task-662897]
config TCT_PRINTK_UART
	default y
	bool "TCT printk UART controller"
	---help---
	control the printk uart log output or not. 
# [Feature]-Add-END by TCTSZ. add uart log output controller. wenzhao.guo@tcl.com, 2015/09/23, for [Task-662897]
endif

#add dirty file detector for defect 432029 by pingping.jiang 20150715 begin
config TCT_DIRTY_FILES_DETECTOR
        default n
        depends on TCT_DEBUG
        bool "TCT dirty file detector for /system partition and /custpack partition"
#add dirty file detector for defect 432029 by pingping.jiang 20150715 end

# [Feature]-Add-BEGIN by TCTSZ. add mlog. xiaoju.liang@tcl.com, 2015/11/10, for [Task-897707]
config TCT_DEBUG_MLOG
	default n
	tristate "print modem log to kmsg."
	---help---
	  print modem log to kmsg.
# [Feature]-Add-END by TCTSZ. xiaoju.liang@tcl.com, 2015/11/10, for [Task-897707]

#add by junfeng.zhou for add sbl1 log begin .
config TCT_DEBUG_MORELOG
	default y
	tristate "print more log to kernel."
	---help---
	  print more log to kernel.
#add by junfeng.zhou for add sbl1 log end .
```

## drivers/gpio_exp/Kconfig
```kconfig
config GPIO_EXP
	tristate "PCAL6416A GPIO expander"
	depends on I2C
	help
	  GPIO driver for PCAL6416A I2C-based GPIO expander.
```

## drivers/input/misc/Pixi445SPR/Kconfig
```kconfig
config PIXI445SPR_STK3X1X
	tristate "STK3X1X TCT device driver"
	depends on I2C
	help
	  Say Y here you want to enable for the sitronix stk3x1x tct
	  light and proximity sensors driver.
```

## drivers/input/misc/mmc3530/Kconfig
```kconfig
config SENSORS_MMC3530KJ
	tristate "MMC3530KJ 3-axis magnetic sensor driver"
	depends on I2C
	help
	  Say Y here if you want to enable the MMC3530KJ magnetic sensor
	  driver.

	  To compile this driver as a module, choose M here: the
	  module will be called mmc3530KJ.
```

## drivers/input/misc/pixi445c/Kconfig
```kconfig
#
# Input misc drivers configuration
#

config SENSORS_STK3X1X_PIXI445CRICKET
	tristate "STK3X1X proximity and ambient light sensor"
	depends on I2C
	default n
	help
	  Say Y here you want to enable for the sitronix stk3x1x
	  light and proximity sensors driver.

	  To compile this driver as a module, choose M here: the
	  module will be called stk3x1x.

config SENSORS_BMA2X2_PIXI445CRICKET
	tristate "BMA2x2 acceleration sensor support"
	depends on I2C
	default n
	help
	  If you say yes here, you get support for Bosch Sensortec's
	  G-sensor BMA223.
```

## drivers/input/touchscreen/Goplay2/gt615/Kconfig
```kconfig
config TOUCHSCREEN_GT615_GOPLAY2           
       tristate "GT615 touchscreen"
	default n
       depends on I2C
       help
         Say Y here if you have a GT615 touchscreen on TCL GOPLAY2.
         If unsure, say N.
         To compile this driver as a module, choose M here: the
         module will be called GT615.
```

## drivers/input/touchscreen/Pixi3454GSPR/ft6336/Kconfig
```kconfig
#
# FocalTech FT6336 Touchscreen driver
#

config FT6336_TOUCHPANEL_DRIVER
	tristate "FocalTech FT6336 touchpanel driver"
	depends on FT6336_TOUCHSCREEN_DRIVER
	help
	  This is the main file for touchpanel driver for FocalTech FT6336
	  touchscreens.

	  Say Y here if you have a FocalTech FT6336 touchscreen connected
	  to your system.

	  If unsure, say N.

	  To compile this driver as a module, choose M here: the
	  module will be called FT6336_update.

config FT6336_TOUCHPANEL_UPDATE
	tristate "FocalTech FT6336 touchpanel auto update support"
	depends on FT6336_TOUCHPANEL_DRIVER
	help
	  This enables support for firmware update for FocalTech FT6336
	  touchscreens.

	  Say Y here if you have a FocalTech FT6336 touchscreen connected
	  to your system.

	  If unsure, say N.

	  To compile this driver as a module, choose M here: the
	  module will be called FT6336_update.

config FT6336_TOUCHPANEL_DEBUG
	tristate "FocalTech FT6336 Tools for debuging"
	depends on FT6336_TOUCHPANEL_DRIVER
	help
	  This is application debug interface support for FocalTech FT6336
	  touchscreens.

	  Say Y here if you want to have a Android app debug interface
	  to your system.

	  If unsure, say N.

	  To compile this driver as a module, choose M here: the
	  module will be called FT6336_update.
```

## drivers/input/touchscreen/Pixi445SPR/ft3307/Kconfig
```kconfig
#
# FocalTech FT3307 Touchscreen driver
#

config FT3307_TOUCHPANEL_DRIVER
	tristate "FocalTech FT3307 touchpanel driver"
	depends on FT3307_TOUCHSCREEN_DRIVER
	help
	  This is the main file for touchpanel driver for FocalTech FT3307
	  touchscreens.

	  Say Y here if you have a FocalTech FT3307 touchscreen connected
	  to your system.

	  If unsure, say N.

	  To compile this driver as a module, choose M here: the
	  module will be called FT3307_update.

config FT3307_TOUCHPANEL_UPDATE
	tristate "FocalTech FT3307 touchpanel auto update support"
	depends on FT3307_TOUCHPANEL_DRIVER
	help
	  This enables support for firmware update for FocalTech FT3307
	  touchscreens.

	  Say Y here if you have a FocalTech FT3307 touchscreen connected
	  to your system.

	  If unsure, say N.

	  To compile this driver as a module, choose M here: the
	  module will be called FT3307_update.

config FT3307_TOUCHPANEL_DEBUG
	tristate "FocalTech FT3307 Tools for debuging"
	depends on FT3307_TOUCHPANEL_DRIVER
	help
	  This is application debug interface support for FocalTech FT3307
	  touchscreens.

	  Say Y here if you want to have a Android app debug interface
	  to your system.

	  If unsure, say N.

	  To compile this driver as a module, choose M here: the
	  module will be called FT6336_update.
```

## drivers/input/touchscreen/Pixi464G/melfas_mip4_mms438/Kconfig
```kconfig
#
# Kconfig for MELFAS MIP4 Touchscreen Driver
#

if INPUT_TOUCHSCREEN

config TOUCHSCREEN_MELFAS_MMS438
        tristate "MELFAS MMS438 Touchscreen"
        depends on I2C
        help
          Say Y here if you have a MELFAS MMS438 touchscreen device in your system.

          If unsure, say N.

          To compile this driver as a module, choose M here: the module will be called mip4_ts.

config TOUCHSCREEN_MELFAS_MMS449
        tristate "MELFAS MMS449 Touchscreen"
        depends on I2C
        help
          Say Y here if you have a MELFAS MMS449 touchscreen device in your system.

          If unsure, say N.

          To compile this driver as a module, choose M here: the module will be called mip4_ts.

config TOUCHSCREEN_MELFAS_MMS458
        tristate "MELFAS MMS458 Touchscreen"
        depends on I2C
        help
          Say Y here if you have a MELFAS MMS458 touchscreen device in your system.

          If unsure, say N.

          To compile this driver as a module, choose M here: the module will be called mip4_ts.

config TOUCHSCREEN_MELFAS_MMS500
        tristate "MELFAS MMS500 Touchscreen"
        depends on I2C
        help
          Say Y here if you have a MELFAS MMS500 touchscreen device in your system.

          If unsure, say N.

          To compile this driver as a module, choose M here: the module will be called mip4_ts.

config TOUCHSCREEN_MELFAS_MCS8040L
        tristate "MELFAS MCS8040L Touchscreen"
        depends on I2C
        help
          Say Y here if you have a MELFAS MCS8040L touchscreen device in your system.

          If unsure, say N.

          To compile this driver as a module, choose M here: the module will be called mip4_ts.

config TOUCHSCREEN_MELFAS_MIT200
        tristate "MELFAS MIT200 Touchscreen"
        depends on I2C
        help
          Say Y here if you have a MELFAS MIT200 touchscreen device in your system.

          If unsure, say N.

          To compile this driver as a module, choose M here: the module will be called mip4_ts.

config TOUCHSCREEN_MELFAS_MIT300
        tristate "MELFAS MIT300 Touchscreen"
        depends on I2C
        help
          Say Y here if you have a MELFAS MIT300 touchscreen device in your system.

          If unsure, say N.

          To compile this driver as a module, choose M here: the module will be called mip4_ts.

endif
```

## drivers/input/touchscreen/pixi445c/ft3307/Kconfig
```kconfig
#
# FocalTech FTS Touchscreen driver
#

config TOUCHSCREEN_FT3307_POP445C          
        tristate "focaltech touchscreen"
	default n
        depends on I2C
        help
         Say Y here if you have a focaltech touchscreen.
         If unsure, say N.
         To compile this driver as a module, choose M here: the
         module will be called focaltech.

config TOUCHPANEL_PROXIMITY_SENSOR
        tristate "focaltech touchscreen"
	default n
        depends on I2C
        help
         Say Y here if you have want to open the function.
         If unsure, say N.
         To compile this driver as a module, choose M here: the
         module will be called focaltech.
```

## drivers/input/touchscreen/pixi445c/msg2238/Kconfig
```kconfig
config TOUCHSCREEN_MSG2238_POP445C          
       tristate "MSG2238 touchscreen"
       depends on I2C
       help
         Say Y here if you have a MSG2238 touchscreen on TCL PIXI3.
         If unsure, say N.
         To compile this driver as a module, choose M here: the
         module will be called MSG2238.
```

## drivers/input/touchscreen/pop45/ft3427/Kconfig
```kconfig
config TOUCHSCREEN_FTS_FT3427            
       tristate "focaltech touchscreen"
	default n
       depends on I2C
       help
         Say Y here if you have a focaltech touchscreen.
         If unsure, say N.
         To compile this driver as a module, choose M here: the
         module will be called focaltech.
```

## drivers/input/touchscreen/pop455c/gt5668/Kconfig
```kconfig
config TOUCHSCREEN_GT5668            
       tristate "GT5668 touchscreen"
	default n
       depends on I2C
       help
         Say Y here if you have a GT5668 touchscreen on TCL Pop4-5.5C.
         If unsure, say N.
         To compile this driver as a module, choose M here: the
         module will be called GT5668.
```

## drivers/input/touchscreen/pop45c/gt615/Kconfig
```kconfig
config TOUCHSCREEN_GT615           
       tristate "GT615 touchscreen"
	default n
       depends on I2C
       help
         Say Y here if you have a GT615 touchscreen on TCL POP45C.
         If unsure, say N.
         To compile this driver as a module, choose M here: the
         module will be called GT615.
```
